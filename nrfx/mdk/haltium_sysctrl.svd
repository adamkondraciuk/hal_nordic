# haltium_sysctrl register map
Vendor: Nordic Semiconductor; Series: nRFHaltium; File version: 1
nRFHaltium reference description for system-on-chip with many ARM 32-bit Cortex-M33 microcontrollers
Registers are 32-bit, read-write, reset 0x0 unless marked. A register's access mark holds for its fields unless they carry their own. Offsets are from the block's base; lines under a group give offsets from that group; [hi:lo] are bit positions; {n}, {i} and the like mark numbered series; 'fields as' and 'values as' point back to an identical list; <NAME> marks a mode.

## Memory map
0x0E000000 L2CACHEDATA_S size 0x1000 — CACHEDATA
0x0E008000 L2CACHEINFO_S size 0x1000 — CACHEINFO
0x4F095000 EXMIF_NS size 0x1000 — External Memory Interface 0
0x4F8D1000 GLOBAL_GIPCT0_NS size 0x1000 — IPCT APB registers 0
0x4F8D2000 GLOBAL_GMUTEX0_NS size 0x1000 — MUTEX 0
0x4F8D3000 GLOBAL_GGENERIC55_NS size 0x1000 — GENERIC 10
0x4F8D4000 GLOBAL_GGENERIC56_NS size 0x1000 — GENERIC 12
0x4F8D5000 GLOBAL_GGENERIC57_NS size 0x1000 — GENERIC 14
0x4F8D6000 GLOBAL_GGENERIC58_NS size 0x1000 — GENERIC 16
0x4F8E1000 GLOBAL_GDPPIC0_NS size 0x1000 — Distributed programmable peripheral interconnect controller 0
0x4F8E2000 GLOBAL_GTIMER0_NS size 0x1000 — Timer/Counter 0
0x4F8E3000 GLOBAL_GTIMER1_NS size 0x1000 — Timer/Counter 2
0x4F8E4000 GLOBAL_PWM0_NS size 0x1000 — Pulse width modulation unit 0
0x4F8E5000 GLOBAL_SPIM0_NS size 0x1000 — Serial Peripheral Interface Master with EasyDMA 0
0x4F8E5000 GLOBAL_SPIS0_NS size 0x1000 — SPI Slave 0
0x4F8E5000 GLOBAL_TWIM0_NS size 0x1000 — I2C compatible Two-Wire Master Interface with EasyDMA 0
0x4F8E5000 GLOBAL_TWIS0_NS size 0x1000 — I2C compatible Two-Wire Slave Interface with EasyDMA 0
0x4F8E5000 GLOBAL_UARTE0_NS size 0x1000 — UART with EasyDMA 0
0x4F8E6000 GLOBAL_HSSPIM0_NS size 0x1000 — Serial Peripheral Interface Master with EasyDMA 0
0x4F8E7000 GLOBAL_HSSPIM1_NS size 0x1000 — Serial Peripheral Interface Master with EasyDMA 2
0x4F921000 GLOBAL_GIPCT1_NS size 0x1000 — IPCT APB registers 2
0x4F922000 GLOBAL_GDPPIC1_NS size 0x1000 — Distributed programmable peripheral interconnect controller 2
0x4F927000 GLOBAL_GMUTEX1_NS size 0x1000 — MUTEX 1
0x4F928000 GLOBAL_GRTC0_NS size 0x1000 — Real-time counter 0
0x4F929000 GLOBAL_GRTC1_NS size 0x1000 — Real-time counter 2
0x4F92B000 GLOBAL_GWDT1_NS size 0x1000 — Watchdog Timer 1
0x4F92C000 GLOBAL_GWDT2_NS size 0x1000 — Watchdog Timer 3
0x4F934000 GLOBAL_GPIOTE0_NS size 0x1000 — GPIO Tasks and Events 0
0x4F935000 GLOBAL_GPIOTE1_NS size 0x1000 — GPIO Tasks and Events 2
{0x4F938000+0x200*n} GLOBAL_P{n}_NS size 0x200 (n=0..7) — GPIO Port {n}
{0x4F938000+0x200*n} GLOBAL_P{n}_NS size 0x200 (n=8..15) — GPIO Port {n+8}
0x4F939E00 GLOBAL_GGPIOINTERNAL_NS size 0x2000 — GPIO Internal 0
0x4F981000 GLOBAL_GDPPIC2_NS size 0x1000 — Distributed programmable peripheral interconnect controller 4
0x4F982000 GLOBAL_SAADC_NS size 0x1000 — Analog to Digital Converter 0
0x4F983000 GLOBAL_COMP_NS size 0x1000 — Comparator 0
0x4F983000 GLOBAL_LPCOMP_NS size 0x1000 — Low-power comparator 0
0x4F984000 GLOBAL_TEMP_NS size 0x1000 — Temperature Sensor 0
0x4F985000 GLOBAL_NFCT_NS size 0x1000 — NFC-A compatible radio 0
0x4F991000 GLOBAL_GDPPIC3_NS size 0x1000 — Distributed programmable peripheral interconnect controller 6
0x4F992000 GLOBAL_I2S_NS size 0x1000 — Inter-IC Sound 0
0x4F993000 GLOBAL_PDM_NS size 0x1000 — Pulse Density Modulation (Digital Microphone) Interface 0
0x4F994000 GLOBAL_QDEC0_NS size 0x1000 — Quadrature Decoder 0
0x4F995000 GLOBAL_QDEC1_NS size 0x1000 — Quadrature Decoder 2
0x4F996000 GLOBAL_SIMIF_NS size 0x1000 — SIM card interface 0
0x4F997000 GLOBAL_GMIPIRFFE_NS size 0x1000 — MipiRffe Master 0
0x4F998000 GLOBAL_TWIM9_NS size 0x1000 — I2C compatible Two-Wire Master Interface with EasyDMA 2
0x4F9A1000 GLOBAL_GDPPIC4_NS size 0x1000 — Distributed programmable peripheral interconnect controller 8
0x4F9A2000 GLOBAL_GTIMER2_NS size 0x1000 — Timer/Counter 4
0x4F9A3000 GLOBAL_GTIMER3_NS size 0x1000 — Timer/Counter 6
0x4F9A4000 GLOBAL_PWM1_NS size 0x1000 — Pulse width modulation unit 2
0x4F9A5000 GLOBAL_SPIM1_NS size 0x1000 — Serial Peripheral Interface Master with EasyDMA 2
0x4F9A5000 GLOBAL_SPIS1_NS size 0x1000 — SPI Slave 2
0x4F9A5000 GLOBAL_TWIM1_NS size 0x1000 — I2C compatible Two-Wire Master Interface with EasyDMA 4
0x4F9A5000 GLOBAL_TWIS1_NS size 0x1000 — I2C compatible Two-Wire Slave Interface with EasyDMA 2
0x4F9A5000 GLOBAL_UARTE1_NS size 0x1000 — UART with EasyDMA 2
0x4F9A6000 GLOBAL_SPIM2_NS size 0x1000 — Serial Peripheral Interface Master with EasyDMA 4
0x4F9A6000 GLOBAL_SPIS2_NS size 0x1000 — SPI Slave 4
0x4F9A6000 GLOBAL_TWIM2_NS size 0x1000 — I2C compatible Two-Wire Master Interface with EasyDMA 6
0x4F9A6000 GLOBAL_TWIS2_NS size 0x1000 — I2C compatible Two-Wire Slave Interface with EasyDMA 4
0x4F9A6000 GLOBAL_UARTE2_NS size 0x1000 — UART with EasyDMA 4
0x4F9B1000 GLOBAL_GDPPIC5_NS size 0x1000 — Distributed programmable peripheral interconnect controller 10
0x4F9B2000 GLOBAL_GTIMER4_NS size 0x1000 — Timer/Counter 8
0x4F9B3000 GLOBAL_GTIMER5_NS size 0x1000 — Timer/Counter 10
0x4F9B4000 GLOBAL_PWM2_NS size 0x1000 — Pulse width modulation unit 4
0x4F9B5000 GLOBAL_SPIM3_NS size 0x1000 — Serial Peripheral Interface Master with EasyDMA 6
0x4F9B5000 GLOBAL_SPIS3_NS size 0x1000 — SPI Slave 6
0x4F9B5000 GLOBAL_TWIM3_NS size 0x1000 — I2C compatible Two-Wire Master Interface with EasyDMA 8
0x4F9B5000 GLOBAL_TWIS3_NS size 0x1000 — I2C compatible Two-Wire Slave Interface with EasyDMA 6
0x4F9B5000 GLOBAL_UARTE3_NS size 0x1000 — UART with EasyDMA 6
0x4F9B6000 GLOBAL_SPIM4_NS size 0x1000 — Serial Peripheral Interface Master with EasyDMA 8
0x4F9B6000 GLOBAL_SPIS4_NS size 0x1000 — SPI Slave 8
0x4F9B6000 GLOBAL_TWIM4_NS size 0x1000 — I2C compatible Two-Wire Master Interface with EasyDMA 10
0x4F9B6000 GLOBAL_TWIS4_NS size 0x1000 — I2C compatible Two-Wire Slave Interface with EasyDMA 8
0x4F9B6000 GLOBAL_UARTE4_NS size 0x1000 — UART with EasyDMA 8
0x4F9C1000 GLOBAL_GDPPIC6_NS size 0x1000 — Distributed programmable peripheral interconnect controller 12
0x4F9C2000 GLOBAL_GTIMER6_NS size 0x1000 — Timer/Counter 12
0x4F9C3000 GLOBAL_GTIMER7_NS size 0x1000 — Timer/Counter 14
0x4F9C4000 GLOBAL_PWM3_NS size 0x1000 — Pulse width modulation unit 6
0x4F9C5000 GLOBAL_SPIM5_NS size 0x1000 — Serial Peripheral Interface Master with EasyDMA 10
0x4F9C5000 GLOBAL_SPIS5_NS size 0x1000 — SPI Slave 10
0x4F9C5000 GLOBAL_TWIM5_NS size 0x1000 — I2C compatible Two-Wire Master Interface with EasyDMA 12
0x4F9C5000 GLOBAL_TWIS5_NS size 0x1000 — I2C compatible Two-Wire Slave Interface with EasyDMA 10
0x4F9C5000 GLOBAL_UARTE5_NS size 0x1000 — UART with EasyDMA 10
0x4F9C6000 GLOBAL_SPIM6_NS size 0x1000 — Serial Peripheral Interface Master with EasyDMA 12
0x4F9C6000 GLOBAL_SPIS6_NS size 0x1000 — SPI Slave 12
0x4F9C6000 GLOBAL_TWIM6_NS size 0x1000 — I2C compatible Two-Wire Master Interface with EasyDMA 14
0x4F9C6000 GLOBAL_TWIS6_NS size 0x1000 — I2C compatible Two-Wire Slave Interface with EasyDMA 12
0x4F9C6000 GLOBAL_UARTE6_NS size 0x1000 — UART with EasyDMA 12
0x4F9D1000 GLOBAL_GDPPIC7_NS size 0x1000 — Distributed programmable peripheral interconnect controller 14
0x4F9D2000 GLOBAL_GTIMER8_NS size 0x1000 — Timer/Counter 16
0x4F9D3000 GLOBAL_GTIMER9_NS size 0x1000 — Timer/Counter 18
0x4F9D4000 GLOBAL_PWM4_NS size 0x1000 — Pulse width modulation unit 8
0x4F9D5000 GLOBAL_SPIM7_NS size 0x1000 — Serial Peripheral Interface Master with EasyDMA 14
0x4F9D5000 GLOBAL_SPIS7_NS size 0x1000 — SPI Slave 14
0x4F9D5000 GLOBAL_TWIM7_NS size 0x1000 — I2C compatible Two-Wire Master Interface with EasyDMA 16
0x4F9D5000 GLOBAL_TWIS7_NS size 0x1000 — I2C compatible Two-Wire Slave Interface with EasyDMA 14
0x4F9D5000 GLOBAL_UARTE7_NS size 0x1000 — UART with EasyDMA 14
0x4F9D6000 GLOBAL_SPIM8_NS size 0x1000 — Serial Peripheral Interface Master with EasyDMA 16
0x4F9D6000 GLOBAL_SPIS8_NS size 0x1000 — SPI Slave 16
0x4F9D6000 GLOBAL_TWIM8_NS size 0x1000 — I2C compatible Two-Wire Master Interface with EasyDMA 18
0x4F9D6000 GLOBAL_TWIS8_NS size 0x1000 — I2C compatible Two-Wire Slave Interface with EasyDMA 16
0x4F9D6000 GLOBAL_UARTE8_NS size 0x1000 — UART with EasyDMA 16
0x5F082000 L2CACHE_S size 0x1000 — Cache
0x5F083000 GRAMC00_S size 0x1000 — RAM Controller 0
0x5F084000 GRAMC01_S size 0x1000 — RAM Controller 1
0x5F085000 GGENERIC2_S size 0x1000 — GENERIC 7
0x5F092000 MRAMC00_S size 0x1000 — MRAM controller 0
0x5F093000 MRAMC01_S size 0x1000 — MRAM controller 1
0x5F094000 EXMEE_S size 0x1000 — EXternal Memory Encryption Engine
0x5F095000 EXMIF_S size 0x1000 — External Memory Interface 1
0x5F096000 GGENERIC3_S size 0x1000 — GENERIC 8
0x5F097000 GMVDMA_S size 0x1000 — MVDMA performs direct-memory-accesses between memories. Data is transferred according to job descriptor lists. Each transfer has corresponding source and sink descriptor lists with matching data amounts. The lists are in memory and they contain data buffer information, address pointers, buffer sizes and data type attributes. MVDMA IP connects to an ARM standard AXI4 bus.
0x5F098000 GPPIB0_S size 0x1000 — PPIB APB registers 0
0x5F8C2000 GAMBIX0_S size 0x1000 — AMBA interconnect 0
0x5F8C3000 GRAMC10_S size 0x1000 — RAM Controller 2
0x5F8C4000 GRAMC11_S size 0x1000 — RAM Controller 3
0x5F8C5000 OTPC00_S size 0x1000 — OTP controller
0x5F8C6000 GROMC00_S size 0x1000 — RAM Controller
0x5F8C7000 GMEMCONF0_S size 0x1000 — Memory configuration 0
0x5F8C8000 CLIC_S size 0x2000 — Core-Local Interrupt Controller
0x5F8CB000 VPR_S size 0x1000 — VPR APB registers
0x5F8CD000 GHSFLL_S size 0x1000 — HSFLL
0x5F8CE000 GLRC0_S size 0x1000 — LRC 0
0x5F8CF000 GGENERIC6_S size 0x1000 — GENERIC 9
0x5F8D1000 GLOBAL_GIPCT0_S size 0x1000 — IPCT APB registers 1
0x5F8D3000 GLOBAL_GGENERIC55_S size 0x1000 — GENERIC 11
0x5F8D4000 GLOBAL_GGENERIC56_S size 0x1000 — GENERIC 13
0x5F8D5000 GLOBAL_GGENERIC57_S size 0x1000 — GENERIC 15
0x5F8D6000 GLOBAL_GGENERIC58_S size 0x1000 — GENERIC 17
0x5F8E1000 GLOBAL_GDPPIC0_S size 0x1000 — Distributed programmable peripheral interconnect controller 1
0x5F8E2000 GLOBAL_GTIMER0_S size 0x1000 — Timer/Counter 1
0x5F8E3000 GLOBAL_GTIMER1_S size 0x1000 — Timer/Counter 3
0x5F8E4000 GLOBAL_PWM0_S size 0x1000 — Pulse width modulation unit 1
0x5F8E5000 GLOBAL_SPIM0_S size 0x1000 — Serial Peripheral Interface Master with EasyDMA 1
0x5F8E5000 GLOBAL_SPIS0_S size 0x1000 — SPI Slave 1
0x5F8E5000 GLOBAL_TWIM0_S size 0x1000 — I2C compatible Two-Wire Master Interface with EasyDMA 1
0x5F8E5000 GLOBAL_TWIS0_S size 0x1000 — I2C compatible Two-Wire Slave Interface with EasyDMA 1
0x5F8E5000 GLOBAL_UARTE0_S size 0x1000 — UART with EasyDMA 1
0x5F8E6000 GLOBAL_HSSPIM0_S size 0x1000 — Serial Peripheral Interface Master with EasyDMA 1
0x5F8E7000 GLOBAL_HSSPIM1_S size 0x1000 — Serial Peripheral Interface Master with EasyDMA 3
0x5F8EF000 GPPIB1_S size 0x1000 — PPIB APB registers 1
0x5F902000 GAMBIX1_S size 0x1000 — AMBA interconnect 1
0x5F903000 GRAMC20_S size 0x1000 — RAM Controller 4
0x5F904000 GRAMC21_S size 0x1000 — RAM Controller 5
0x5F905000 GMEMCONF1_S size 0x1000 — Memory configuration 1
0x5F90E000 GGENERIC7_S size 0x1000 — GENERIC 18
0x5F90F000 GGENERIC8_S size 0x1000 — GENERIC 19
0x5F921000 GLOBAL_GIPCT1_S size 0x1000 — IPCT APB registers 3
0x5F922000 GLOBAL_GDPPIC1_S size 0x1000 — Distributed programmable peripheral interconnect controller 3
0x5F925000 GPPIB2_S size 0x1000 — PPIB APB registers 2
0x5F926000 GPPIB3_S size 0x1000 — PPIB APB registers 3
0x5F928000 GLOBAL_GRTC0_S size 0x1000 — Real-time counter 1
0x5F929000 GLOBAL_GRTC1_S size 0x1000 — Real-time counter 3
0x5F92A000 GWDT0_S size 0x1000 — Watchdog Timer 0
0x5F92B000 GLOBAL_GWDT1_S size 0x1000 — Watchdog Timer 2
0x5F92C000 GLOBAL_GWDT2_S size 0x1000 — Watchdog Timer 4
0x5F934000 GLOBAL_GPIOTE0_S size 0x1000 — GPIO Tasks and Events 1
0x5F935000 GLOBAL_GPIOTE1_S size 0x1000 — GPIO Tasks and Events 3
{0x5F938000+0x200*n} GLOBAL_P{n}_S size 0x200 (n=0..7) — GPIO Port {n+8}
{0x5F938000+0x200*n} GLOBAL_P{n}_S size 0x200 (n=8..15) — GPIO Port {n+16}
0x5F939E00 GLOBAL_GGPIOINTERNAL_S size 0x2000 — GPIO Internal 1
0x5F93C000 GGENERIC9_S size 0x1000 — GENERIC 20
0x5F93E000 GLRC1_S size 0x1000 — LRC 1
0x5F93F000 GGENERIC12_S size 0x1000 — GENERIC 21
0x5F941000 GRTC_S size 0x1000 — Global Real-time counter
0x5F942000 GGENERIC13_S size 0x1000 — GENERIC 22
0x5F943000 RESETHUB_S size 0x1000 — Reset hub
0x5F944000 GGENERIC14_S size 0x1000 — GENERIC 23
0x5F945000 GGENERIC15_S size 0x1000 — GENERIC 24
0x5F946000 GGENERIC16_S size 0x1000 — GENERIC 25
0x5F950000 GGENERIC17_S size 0x1000 — GENERIC 26
0x5F951000 LFRC_S size 0x1000 — LFRC
0x5F952000 GGENERIC18_S size 0x1000 — GENERIC 27
0x5F953000 GGENERIC19_S size 0x1000 — GENERIC 28
0x5F954000 FLL16M_S size 0x1000 — FLL16M
0x5F955000 GGENERIC20_S size 0x1000 — GENERIC 29
0x5F956000 GGENERIC21_S size 0x1000 — GENERIC 30
0x5F957000 GGENERIC22_S size 0x1000 — GENERIC 31
0x5F960000 GGENERIC23_S size 0x1000 — GENERIC 32
0x5F961000 VREGMAIN_S size 0x1000 — VREGMAIN
0x5F962000 VREGAO1V8_S size 0x1000 — VREGAO1V8
0x5F963000 VREG1V0_S size 0x1000 — VREG1V0
0x5F964000 VREGAO0V8_S size 0x1000 — VREGAO0V8
0x5F965000 VREGVS0V8_S size 0x1000 — VREGVS0V8
0x5F966000 VREGSU_S size 0x1000 — VREGSU
0x5F967000 GGENERIC29_S size 0x1000 — GENERIC 33
0x5F968000 GGENERIC30_S size 0x1000 — GENERIC 34
0x5F969000 VREGMRAM00_S size 0x1000 — VREGMRAM 0
0x5F96A000 VREGMRAM01_S size 0x1000 — VREGMRAM 1
0x5F96B000 GGENERIC32_S size 0x1000 — GENERIC 35
0x5F970000 MBIAS_S size 0x1000 — MBIAS
0x5F971000 VDETAO1V8_S size 0x1000 — VDETAO1V8
0x5F972000 VDETAO0V8_S size 0x1000 — VDETAO0V8
0x5F973000 VDETVS0V8_S size 0x1000 — VDETVS0V8
0x5F974000 GGENERIC36_S size 0x1000 — GENERIC 36
0x5F975000 GGENERIC37_S size 0x1000 — GENERIC 37
0x5F976000 GGENERIC38_S size 0x1000 — GENERIC 38
0x5F977000 GGENERIC39_S size 0x1000 — GENERIC 39
0x5F978000 GGENERIC40_S size 0x1000 — GENERIC 40
0x5F979000 GGENERIC41_S size 0x1000 — GENERIC 41
0x5F97A000 GGENERIC42_S size 0x1000 — GENERIC 42
0x5F981000 GLOBAL_GDPPIC2_S size 0x1000 — Distributed programmable peripheral interconnect controller 5
0x5F982000 GLOBAL_SAADC_S size 0x1000 — Analog to Digital Converter 1
0x5F983000 GLOBAL_COMP_S size 0x1000 — Comparator 1
0x5F983000 GLOBAL_LPCOMP_S size 0x1000 — Low-power comparator 1
0x5F984000 GLOBAL_TEMP_S size 0x1000 — Temperature Sensor 1
0x5F985000 GLOBAL_NFCT_S size 0x1000 — NFC-A compatible radio 1
0x5F98D000 GPPIB4_S size 0x1000 — PPIB APB registers 4
0x5F98E000 GGENERIC43_S size 0x1000 — GENERIC 43
0x5F98F000 GGENERIC44_S size 0x1000 — GENERIC 44
0x5F991000 GLOBAL_GDPPIC3_S size 0x1000 — Distributed programmable peripheral interconnect controller 7
0x5F992000 GLOBAL_I2S_S size 0x1000 — Inter-IC Sound 1
0x5F993000 GLOBAL_PDM_S size 0x1000 — Pulse Density Modulation (Digital Microphone) Interface 1
0x5F994000 GLOBAL_QDEC0_S size 0x1000 — Quadrature Decoder 1
0x5F995000 GLOBAL_QDEC1_S size 0x1000 — Quadrature Decoder 3
0x5F996000 GLOBAL_SIMIF_S size 0x1000 — SIM card interface 1
0x5F997000 GLOBAL_GMIPIRFFE_S size 0x1000 — MipiRffe Master 1
0x5F998000 GLOBAL_TWIM9_S size 0x1000 — I2C compatible Two-Wire Master Interface with EasyDMA 3
0x5F99D000 GPPIB5_S size 0x1000 — PPIB APB registers 5
0x5F99E000 GGENERIC45_S size 0x1000 — GENERIC 45
0x5F99F000 GGENERIC46_S size 0x1000 — GENERIC 46
0x5F9A1000 GLOBAL_GDPPIC4_S size 0x1000 — Distributed programmable peripheral interconnect controller 9
0x5F9A2000 GLOBAL_GTIMER2_S size 0x1000 — Timer/Counter 5
0x5F9A3000 GLOBAL_GTIMER3_S size 0x1000 — Timer/Counter 7
0x5F9A4000 GLOBAL_PWM1_S size 0x1000 — Pulse width modulation unit 3
0x5F9A5000 GLOBAL_SPIM1_S size 0x1000 — Serial Peripheral Interface Master with EasyDMA 3
0x5F9A5000 GLOBAL_SPIS1_S size 0x1000 — SPI Slave 3
0x5F9A5000 GLOBAL_TWIM1_S size 0x1000 — I2C compatible Two-Wire Master Interface with EasyDMA 5
0x5F9A5000 GLOBAL_TWIS1_S size 0x1000 — I2C compatible Two-Wire Slave Interface with EasyDMA 3
0x5F9A5000 GLOBAL_UARTE1_S size 0x1000 — UART with EasyDMA 3
0x5F9A6000 GLOBAL_SPIM2_S size 0x1000 — Serial Peripheral Interface Master with EasyDMA 5
0x5F9A6000 GLOBAL_SPIS2_S size 0x1000 — SPI Slave 5
0x5F9A6000 GLOBAL_TWIM2_S size 0x1000 — I2C compatible Two-Wire Master Interface with EasyDMA 7
0x5F9A6000 GLOBAL_TWIS2_S size 0x1000 — I2C compatible Two-Wire Slave Interface with EasyDMA 5
0x5F9A6000 GLOBAL_UARTE2_S size 0x1000 — UART with EasyDMA 5
0x5F9AD000 GPPIB6_S size 0x1000 — PPIB APB registers 6
0x5F9AE000 GGENERIC47_S size 0x1000 — GENERIC 47
0x5F9AF000 GGENERIC48_S size 0x1000 — GENERIC 48
0x5F9B1000 GLOBAL_GDPPIC5_S size 0x1000 — Distributed programmable peripheral interconnect controller 11
0x5F9B2000 GLOBAL_GTIMER4_S size 0x1000 — Timer/Counter 9
0x5F9B3000 GLOBAL_GTIMER5_S size 0x1000 — Timer/Counter 11
0x5F9B4000 GLOBAL_PWM2_S size 0x1000 — Pulse width modulation unit 5
0x5F9B5000 GLOBAL_SPIM3_S size 0x1000 — Serial Peripheral Interface Master with EasyDMA 7
0x5F9B5000 GLOBAL_SPIS3_S size 0x1000 — SPI Slave 7
0x5F9B5000 GLOBAL_TWIM3_S size 0x1000 — I2C compatible Two-Wire Master Interface with EasyDMA 9
0x5F9B5000 GLOBAL_TWIS3_S size 0x1000 — I2C compatible Two-Wire Slave Interface with EasyDMA 7
0x5F9B5000 GLOBAL_UARTE3_S size 0x1000 — UART with EasyDMA 7
0x5F9B6000 GLOBAL_SPIM4_S size 0x1000 — Serial Peripheral Interface Master with EasyDMA 9
0x5F9B6000 GLOBAL_SPIS4_S size 0x1000 — SPI Slave 9
0x5F9B6000 GLOBAL_TWIM4_S size 0x1000 — I2C compatible Two-Wire Master Interface with EasyDMA 11
0x5F9B6000 GLOBAL_TWIS4_S size 0x1000 — I2C compatible Two-Wire Slave Interface with EasyDMA 9
0x5F9B6000 GLOBAL_UARTE4_S size 0x1000 — UART with EasyDMA 9
0x5F9BD000 GPPIB7_S size 0x1000 — PPIB APB registers 7
0x5F9BE000 GGENERIC49_S size 0x1000 — GENERIC 49
0x5F9BF000 GGENERIC50_S size 0x1000 — GENERIC 50
0x5F9C1000 GLOBAL_GDPPIC6_S size 0x1000 — Distributed programmable peripheral interconnect controller 13
0x5F9C2000 GLOBAL_GTIMER6_S size 0x1000 — Timer/Counter 13
0x5F9C3000 GLOBAL_GTIMER7_S size 0x1000 — Timer/Counter 15
0x5F9C4000 GLOBAL_PWM3_S size 0x1000 — Pulse width modulation unit 7
0x5F9C5000 GLOBAL_SPIM5_S size 0x1000 — Serial Peripheral Interface Master with EasyDMA 11
0x5F9C5000 GLOBAL_SPIS5_S size 0x1000 — SPI Slave 11
0x5F9C5000 GLOBAL_TWIM5_S size 0x1000 — I2C compatible Two-Wire Master Interface with EasyDMA 13
0x5F9C5000 GLOBAL_TWIS5_S size 0x1000 — I2C compatible Two-Wire Slave Interface with EasyDMA 11
0x5F9C5000 GLOBAL_UARTE5_S size 0x1000 — UART with EasyDMA 11
0x5F9C6000 GLOBAL_SPIM6_S size 0x1000 — Serial Peripheral Interface Master with EasyDMA 13
0x5F9C6000 GLOBAL_SPIS6_S size 0x1000 — SPI Slave 13
0x5F9C6000 GLOBAL_TWIM6_S size 0x1000 — I2C compatible Two-Wire Master Interface with EasyDMA 15
0x5F9C6000 GLOBAL_TWIS6_S size 0x1000 — I2C compatible Two-Wire Slave Interface with EasyDMA 13
0x5F9C6000 GLOBAL_UARTE6_S size 0x1000 — UART with EasyDMA 13
0x5F9CD000 GPPIB8_S size 0x1000 — PPIB APB registers 8
0x5F9CE000 GGENERIC51_S size 0x1000 — GENERIC 51
0x5F9CF000 GGENERIC52_S size 0x1000 — GENERIC 52
0x5F9D1000 GLOBAL_GDPPIC7_S size 0x1000 — Distributed programmable peripheral interconnect controller 15
0x5F9D2000 GLOBAL_GTIMER8_S size 0x1000 — Timer/Counter 17
0x5F9D3000 GLOBAL_GTIMER9_S size 0x1000 — Timer/Counter 19
0x5F9D4000 GLOBAL_PWM4_S size 0x1000 — Pulse width modulation unit 9
0x5F9D5000 GLOBAL_SPIM7_S size 0x1000 — Serial Peripheral Interface Master with EasyDMA 15
0x5F9D5000 GLOBAL_SPIS7_S size 0x1000 — SPI Slave 15
0x5F9D5000 GLOBAL_TWIM7_S size 0x1000 — I2C compatible Two-Wire Master Interface with EasyDMA 17
0x5F9D5000 GLOBAL_TWIS7_S size 0x1000 — I2C compatible Two-Wire Slave Interface with EasyDMA 15
0x5F9D5000 GLOBAL_UARTE7_S size 0x1000 — UART with EasyDMA 15
0x5F9D6000 GLOBAL_SPIM8_S size 0x1000 — Serial Peripheral Interface Master with EasyDMA 17
0x5F9D6000 GLOBAL_SPIS8_S size 0x1000 — SPI Slave 17
0x5F9D6000 GLOBAL_TWIM8_S size 0x1000 — I2C compatible Two-Wire Master Interface with EasyDMA 19
0x5F9D6000 GLOBAL_TWIS8_S size 0x1000 — I2C compatible Two-Wire Slave Interface with EasyDMA 17
0x5F9D6000 GLOBAL_UARTE8_S size 0x1000 — UART with EasyDMA 17
0x5F9DD000 GPPIB9_S size 0x1000 — PPIB APB registers 9
0x5F9DE000 GGENERIC53_S size 0x1000 — GENERIC 53
0x5F9DF000 GGENERIC54_S size 0x1000 — GENERIC 54
0x5F9E0000 GLOBAL_EASYVDMA_NS size 0x1000 — Vector-based DMA.
0xBF001000 GLOBAL_GGENERIC59_NS size 0x1000 — GENERIC 0
0xBF001000 GLOBAL_GGENERIC59_S size 0x1000 — GENERIC 1
0xBF003000 GLOBAL_GGENERIC60_NS size 0x1000 — GENERIC 2
0xBF003000 GLOBAL_GGENERIC60_S size 0x1000 — GENERIC 3
0xBF041000 GLOBAL_TSGEN_NS size 0x1000 — GENERIC 4
0xBF042000 GLOBAL_STM_NS size 0x1000 — System Trace Macrocell
0xBF043000 GLOBAL_TPIU_NS size 0x1000 — Trace Port Interface Unit
0xBF044000 GLOBAL_ETB_NS size 0x1000 — GENERIC 5
0xBF045000 GLOBAL_ETR_NS size 0x1000 — GENERIC 6
0xBF046000 GLOBAL_CTI0_NS size 0x1000 — Cross-Trigger Interface control. NOTE: this is not a separate peripheral, but describes CM33 functionality. 0
0xBF047000 GLOBAL_CTI1_NS size 0x1000 — Cross-Trigger Interface control. NOTE: this is not a separate peripheral, but describes CM33 functionality. 1
0xBF048000 GLOBAL_ATBREPLICATOR0_NS size 0x1000 — ATB Replicator module 0
0xBF049000 GLOBAL_ATBREPLICATOR1_NS size 0x1000 — ATB Replicator module 1
0xBF04A000 GLOBAL_ATBREPLICATOR2_NS size 0x1000 — ATB Replicator module 2
0xBF04B000 GLOBAL_ATBREPLICATOR3_NS size 0x1000 — ATB Replicator module 3
0xBF04C000 GLOBAL_ATBFUNNEL0_NS size 0x1000 — ATB funnel module 0
0xBF04D000 GLOBAL_ATBFUNNEL1_NS size 0x1000 — ATB funnel module 1
0xBF04E000 GLOBAL_ATBFUNNEL2_NS size 0x1000 — ATB funnel module 2
0xBF04F000 GLOBAL_ATBFUNNEL3_NS size 0x1000 — ATB funnel module 3

## Interrupts
104 GPIOTE00 (GLOBAL_GPIOTE0_NS, GLOBAL_GPIOTE0_S)
105 GPIOTE01 (GLOBAL_GPIOTE0_NS, GLOBAL_GPIOTE0_S)
106 GPIOTE10 (GLOBAL_GPIOTE1_NS, GLOBAL_GPIOTE1_S)
107 GPIOTE11 (GLOBAL_GPIOTE1_NS, GLOBAL_GPIOTE1_S)
130 L2CACHE (L2CACHE_S)
131 GRAMC00 (GRAMC00_S)
132 GRAMC01 (GRAMC01_S)
133 GGENERIC2 (GGENERIC2_S)
146 MRAMC00 (MRAMC00_S)
147 MRAMC01 (MRAMC01_S)
148 EXMEE (EXMEE_S)
150 GGENERIC3 (GGENERIC3_S)
151 GMVDMA (GMVDMA_S)
195 GRAMC10 (GRAMC10_S)
196 GRAMC11 (GRAMC11_S)
197 OTPC00 (OTPC00_S)
198 GROMC00 (GROMC00_S)
203 VPR (VPR_S)
205 GHSFLL (GHSFLL_S)
206 GLRC0 (GLRC0_S)
207 GGENERIC6 (GGENERIC6_S)
209 GIPCT00 (GLOBAL_GIPCT0_NS, GLOBAL_GIPCT0_S)
211 GGENERIC55 (GLOBAL_GGENERIC55_NS, GLOBAL_GGENERIC55_S)
212 GGENERIC56 (GLOBAL_GGENERIC56_NS, GLOBAL_GGENERIC56_S)
213 GGENERIC57 (GLOBAL_GGENERIC57_NS, GLOBAL_GGENERIC57_S)
214 GGENERIC58 (GLOBAL_GGENERIC58_NS, GLOBAL_GGENERIC58_S)
226 GTIMER0 (GLOBAL_GTIMER0_NS, GLOBAL_GTIMER0_S)
227 GTIMER1 (GLOBAL_GTIMER1_NS, GLOBAL_GTIMER1_S)
228 PWM0 (GLOBAL_PWM0_NS, GLOBAL_PWM0_S)
229 SPIM0_SPIS0_TWIM0_TWIS0_UARTE0 (GLOBAL_SPIM0_NS, GLOBAL_SPIS0_NS, GLOBAL_TWIM0_NS, GLOBAL_TWIS0_NS, GLOBAL_UARTE0_NS, GLOBAL_SPIM0_S, GLOBAL_SPIS0_S, GLOBAL_TWIM0_S, GLOBAL_TWIS0_S, GLOBAL_UARTE0_S)
230 HSSPIM0 (GLOBAL_HSSPIM0_NS, GLOBAL_HSSPIM0_S)
231 HSSPIM1 (GLOBAL_HSSPIM1_NS, GLOBAL_HSSPIM1_S)
259 GRAMC20 (GRAMC20_S)
260 GRAMC21 (GRAMC21_S)
270 GGENERIC7 (GGENERIC7_S)
271 GGENERIC8 (GGENERIC8_S)
289 GIPCT10 (GLOBAL_GIPCT1_NS, GLOBAL_GIPCT1_S)
296 GRTC0 (GLOBAL_GRTC0_NS, GLOBAL_GRTC0_S)
297 GRTC1 (GLOBAL_GRTC1_NS, GLOBAL_GRTC1_S)
298 GWDT0 (GWDT0_S)
299 GWDT1 (GLOBAL_GWDT1_NS, GLOBAL_GWDT1_S)
300 GWDT2 (GLOBAL_GWDT2_NS, GLOBAL_GWDT2_S)
316 GGENERIC9 (GGENERIC9_S)
318 GLRC1 (GLRC1_S)
319 GGENERIC12 (GGENERIC12_S)
321 GRTC (GRTC_S)
322 GGENERIC13 (GGENERIC13_S)
323 RESETHUB (RESETHUB_S)
324 GGENERIC14 (GGENERIC14_S)
325 GGENERIC15 (GGENERIC15_S)
326 GGENERIC16 (GGENERIC16_S)
336 GGENERIC17 (GGENERIC17_S)
337 LFRC (LFRC_S)
338 GGENERIC18 (GGENERIC18_S)
339 GGENERIC19 (GGENERIC19_S)
341 GGENERIC20 (GGENERIC20_S)
342 GGENERIC21 (GGENERIC21_S)
343 GGENERIC22 (GGENERIC22_S)
352 GGENERIC23 (GGENERIC23_S)
359 GGENERIC29 (GGENERIC29_S)
360 GGENERIC30 (GGENERIC30_S)
361 VREGMRAM00 (VREGMRAM00_S)
362 VREGMRAM01 (VREGMRAM01_S)
363 GGENERIC32 (GGENERIC32_S)
368 MBIAS (MBIAS_S)
369 VDETAO1V8 (VDETAO1V8_S)
370 VDETAO0V8 (VDETAO0V8_S)
371 VDETVS0V8 (VDETVS0V8_S)
372 GGENERIC36 (GGENERIC36_S)
373 GGENERIC37 (GGENERIC37_S)
374 GGENERIC38 (GGENERIC38_S)
375 GGENERIC39 (GGENERIC39_S)
376 GGENERIC40 (GGENERIC40_S)
377 GGENERIC41 (GGENERIC41_S)
378 GGENERIC42 (GGENERIC42_S)
386 SAADC (GLOBAL_SAADC_NS, GLOBAL_SAADC_S)
387 COMP_LPCOMP (GLOBAL_COMP_NS, GLOBAL_LPCOMP_NS, GLOBAL_COMP_S, GLOBAL_LPCOMP_S)
388 TEMP (GLOBAL_TEMP_NS, GLOBAL_TEMP_S)
389 NFCT (GLOBAL_NFCT_NS, GLOBAL_NFCT_S)
398 GGENERIC43 (GGENERIC43_S)
399 GGENERIC44 (GGENERIC44_S)
402 I2S (GLOBAL_I2S_NS, GLOBAL_I2S_S)
403 PDM (GLOBAL_PDM_NS, GLOBAL_PDM_S)
404 QDEC0 (GLOBAL_QDEC0_NS, GLOBAL_QDEC0_S)
405 QDEC1 (GLOBAL_QDEC1_NS, GLOBAL_QDEC1_S)
406 SIMIF (GLOBAL_SIMIF_NS, GLOBAL_SIMIF_S)
407 GMIPIRFFE (GLOBAL_GMIPIRFFE_NS, GLOBAL_GMIPIRFFE_S)
408 TWIM9 (GLOBAL_TWIM9_NS, GLOBAL_TWIM9_S)
414 GGENERIC45 (GGENERIC45_S)
415 GGENERIC46 (GGENERIC46_S)
418 GTIMER2 (GLOBAL_GTIMER2_NS, GLOBAL_GTIMER2_S)
419 GTIMER3 (GLOBAL_GTIMER3_NS, GLOBAL_GTIMER3_S)
420 PWM1 (GLOBAL_PWM1_NS, GLOBAL_PWM1_S)
421 SPIM1_SPIS1_TWIM1_TWIS1_UARTE1 (GLOBAL_SPIM1_NS, GLOBAL_SPIS1_NS, GLOBAL_TWIM1_NS, GLOBAL_TWIS1_NS, GLOBAL_UARTE1_NS, GLOBAL_SPIM1_S, GLOBAL_SPIS1_S, GLOBAL_TWIM1_S, GLOBAL_TWIS1_S, GLOBAL_UARTE1_S)
422 SPIM2_SPIS2_TWIM2_TWIS2_UARTE2 (GLOBAL_SPIM2_NS, GLOBAL_SPIS2_NS, GLOBAL_TWIM2_NS, GLOBAL_TWIS2_NS, GLOBAL_UARTE2_NS, GLOBAL_SPIM2_S, GLOBAL_SPIS2_S, GLOBAL_TWIM2_S, GLOBAL_TWIS2_S, GLOBAL_UARTE2_S)
430 GGENERIC47 (GGENERIC47_S)
431 GGENERIC48 (GGENERIC48_S)
434 GTIMER4 (GLOBAL_GTIMER4_NS, GLOBAL_GTIMER4_S)
435 GTIMER5 (GLOBAL_GTIMER5_NS, GLOBAL_GTIMER5_S)
436 PWM2 (GLOBAL_PWM2_NS, GLOBAL_PWM2_S)
437 SPIM3_SPIS3_TWIM3_TWIS3_UARTE3 (GLOBAL_SPIM3_NS, GLOBAL_SPIS3_NS, GLOBAL_TWIM3_NS, GLOBAL_TWIS3_NS, GLOBAL_UARTE3_NS, GLOBAL_SPIM3_S, GLOBAL_SPIS3_S, GLOBAL_TWIM3_S, GLOBAL_TWIS3_S, GLOBAL_UARTE3_S)
438 SPIM4_SPIS4_TWIM4_TWIS4_UARTE4 (GLOBAL_SPIM4_NS, GLOBAL_SPIS4_NS, GLOBAL_TWIM4_NS, GLOBAL_TWIS4_NS, GLOBAL_UARTE4_NS, GLOBAL_SPIM4_S, GLOBAL_SPIS4_S, GLOBAL_TWIM4_S, GLOBAL_TWIS4_S, GLOBAL_UARTE4_S)
446 GGENERIC49 (GGENERIC49_S)
447 GGENERIC50 (GGENERIC50_S)
450 GTIMER6 (GLOBAL_GTIMER6_NS, GLOBAL_GTIMER6_S)
451 GTIMER7 (GLOBAL_GTIMER7_NS, GLOBAL_GTIMER7_S)
452 PWM3 (GLOBAL_PWM3_NS, GLOBAL_PWM3_S)
453 SPIM5_SPIS5_TWIM5_TWIS5_UARTE5 (GLOBAL_SPIM5_NS, GLOBAL_SPIS5_NS, GLOBAL_TWIM5_NS, GLOBAL_TWIS5_NS, GLOBAL_UARTE5_NS, GLOBAL_SPIM5_S, GLOBAL_SPIS5_S, GLOBAL_TWIM5_S, GLOBAL_TWIS5_S, GLOBAL_UARTE5_S)
454 SPIM6_SPIS6_TWIM6_TWIS6_UARTE6 (GLOBAL_SPIM6_NS, GLOBAL_SPIS6_NS, GLOBAL_TWIM6_NS, GLOBAL_TWIS6_NS, GLOBAL_UARTE6_NS, GLOBAL_SPIM6_S, GLOBAL_SPIS6_S, GLOBAL_TWIM6_S, GLOBAL_TWIS6_S, GLOBAL_UARTE6_S)
462 GGENERIC51 (GGENERIC51_S)
463 GGENERIC52 (GGENERIC52_S)
466 GTIMER8 (GLOBAL_GTIMER8_NS, GLOBAL_GTIMER8_S)
467 GTIMER9 (GLOBAL_GTIMER9_NS, GLOBAL_GTIMER9_S)
468 PWM4 (GLOBAL_PWM4_NS, GLOBAL_PWM4_S)
469 SPIM7_SPIS7_TWIM7_TWIS7_UARTE7 (GLOBAL_SPIM7_NS, GLOBAL_SPIS7_NS, GLOBAL_TWIM7_NS, GLOBAL_TWIS7_NS, GLOBAL_UARTE7_NS, GLOBAL_SPIM7_S, GLOBAL_SPIS7_S, GLOBAL_TWIM7_S, GLOBAL_TWIS7_S, GLOBAL_UARTE7_S)
470 SPIM8_SPIS8_TWIM8_TWIS8_UARTE8 (GLOBAL_SPIM8_NS, GLOBAL_SPIS8_NS, GLOBAL_TWIM8_NS, GLOBAL_TWIS8_NS, GLOBAL_UARTE8_NS, GLOBAL_SPIM8_S, GLOBAL_SPIS8_S, GLOBAL_TWIM8_S, GLOBAL_TWIS8_S, GLOBAL_UARTE8_S)
478 GGENERIC53 (GGENERIC53_S)
479 GGENERIC54 (GGENERIC54_S)

## Further device data
MaxInterrupts=480

## Licence text in the file
Copyright (c) 2010 - 2020, Nordic Semiconductor ASA All rights reserved. Redistribution and use in source and binary forms, with or without modification, are permitted provided that the following conditions are met: 1. Redistributions of source code must retain the above copyright notice, this list of conditions and the following disclaimer. 2. Redistributions in binary form, except as embedded into a Nordic Semiconductor ASA integrated circuit in a product or a software update for such product, must reproduce the above copyright notice, this list of conditions and the following disclaimer in the documentation and/or other materials provided with the distribution. 3. Neither the name of Nordic Semiconductor ASA nor the names of its contributors may be used to endorse or promote products derived from this software without specific prior written permission. 4. This software, with or without modification, must only be used with a Nordic Semiconductor ASA integrated circuit. 5. Any software provided in binary form under this license must not be reverse engineered, decompiled, modified and/or disassembled. THIS SOFTWARE IS PROVIDED BY NORDIC SEMICONDUCTOR ASA "AS IS" AND ANY EXPRESS OR IMPLIED WARRANTIES, INCLUDING, BUT NOT LIMITED TO, THE IMPLIED WARRANTIES OF MERCHANTABILITY, NONINFRINGEMENT, AND FITNESS FOR A PARTICULAR PURPOSE ARE DISCLAIMED. IN NO EVENT SHALL NORDIC SEMICONDUCTOR ASA OR CONTRIBUTORS BE LIABLE FOR ANY DIRECT, INDIRECT, INCIDENTAL, SPECIAL, EXEMPLARY, OR CONSEQUENTIAL DAMAGES (INCLUDING, BUT NOT LIMITED TO, PROCUREMENT OF SUBSTITUTE GOODS OR SERVICES; LOSS OF USE, DATA, OR PROFITS; OR BUSINESS INTERRUPTION) HOWEVER CAUSED AND ON ANY THEORY OF LIABILITY, WHETHER IN CONTRACT, STRICT LIABILITY, OR TORT (INCLUDING NEGLIGENCE OR OTHERWISE) ARISING IN ANY WAY OUT OF THE USE OF THIS SOFTWARE, EVEN IF ADVISED OF THE POSSIBILITY OF SUCH DAMAGE.
