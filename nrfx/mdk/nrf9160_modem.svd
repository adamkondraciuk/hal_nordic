# nrf9160_modem register map
Vendor: Nordic Semiconductor; Series: nrf91; File version: 1
nrf9160 modem reference description for radio MCU with ARM 32-bit Cortex-M4 Microcontroller
CPU: CM4 r0p1, little endian, MPU, FPU, 3 interrupt priority bits
Registers are 32-bit, read-write, reset 0x0 unless marked. A register's access mark holds for its fields unless they carry their own. Offsets are from the block's base; lines under a group give offsets from that group; [hi:lo] are bit positions; {n}, {i} and the like mark numbered series; 'fields as' and 'values as' point back to an identical list; <NAME> marks a mode.

## Memory map
0x00FF0000 FICR_NS size 0x1000 — Factory Information Configuration Registers
0x00FF8000 UICR_NS size 0x1000 — User Information Configuration Registers
0x40000000 AMLI_NS size 0x1000 — AHB Multi-Layer Interface
0x40000000 DCNF_NS size 0x1000 — Domain Configuration Management
0x40001000 MWU_NS size 0x1000 — Memory Watch Unit
0x40010000 MCPLL_NS size 0x1000 — Modem Clock PLL
0x40011000 BBPLL_NS size 0x1000 — Base Band PLL
0x40012000 RCOSC32K_NS size 0x1000 — 32.768 kHz RC oscillator
0x40015000 CLOCK_NS size 0x1000 — Clock Management
0x40015000 POWER_NS size 0x1000 — Power Control
0x40021000 MODEMPERIPH_NS size 0x1000 — Modem peripheral registers
0x40023000 UARTE_NS size 0x1000 — UART with EasyDMA
0x40024000 TIMER1_NS size 0x1000 — Modem Timer/Counter 0
0x40026000 RTC_NS size 0x1000 — Real time counter
0x40027000 LWDT_NS size 0x1000 — Watchdog Timer 0
0x40028000 SWDT_NS size 0x1000 — Watchdog Timer 1
0x40029000 RNG_NS size 0x1000 — Random Number Generator
0x4002A000 SIMIF_NS size 0x1000 — SIM card interface
0x4002B000 RAMBISTHUB_NS size 0x1000 — RAM BIST Hub
0x4002E000 M2M0_NS size 0x1000 — Memory to Memory DMA 0
0x4002F000 M2M1_NS size 0x1000 — Memory to Memory DMA 1
0x40030000 GPIOTE0_NS size 0x1000 — GPIO Tasks and Events 0
0x40031000 GPIOTE1_NS size 0x1000 — GPIO Tasks and Events 1
0x40032000 SECCONTROL_NS size 0x1000 — Secure Control
0x40033000 TIMEMARKMUX_NS size 0x1000 — Timemark multiplexer for LTE System Timer
0x40034000 P0_NS size 0x1000 — GPIO Port
0x40035000 TIMEREVENTSYNC_NS size 0x1000 — Timer event synchronizer
0x40037000 GPIOTE2_NS size 0x1000 — GPIO Tasks and Events 2
0x40039000 TEMP_NS size 0x1000 — Temperature Sensor
0x4003B000 LFCLKCALIBMEAS_NS size 0x1000 — LfClk Calibration Measurement
0x4003C000 TWIM_NS size 0x1000 — I2C compatible Two-Wire Master Interface with EasyDMA
0x4003D000 CTRL_AP_PERI_S size 0x1000 — Control access port
0x40040000 L2CIPHER_NS size 0x1000 — L2 Cipher Registers
0x40042000 AESL2_NS size 0x1000 — AES-128 HW accelerator for LTE L2 security and MAC
0x40043000 SNOW_NS size 0x1000 — Snow 3G Security IP
0x40044000 ZUC_NS size 0x1000 — ZUC LTE L2 security IP
0x40050000 SHA_NS size 0x1000 — SHA-1/SHA-256
0x40051000 TLSAES_NS size 0x1000 — AES cipher with ECB, CBC, CBC-MAC and CTR
0x40052000 DESCIPHER_NS size 0x1000 — DES HW Accelerator
0x40053000 IPC_NS size 0x1000 — Inter Processor Communication
0x40056000 TIMER0_NS size 0x1000 — Modem Timer/Counter 1
0x40060000 ACL_NS size 0x1000 — Access control lists
0x40060000 KMU_NS size 0x1000 — Key Management Unit
0x40060000 NVMC_NS size 0x1000 — Non Volatile Memory Controller
0x40061000 VMC_NS size 0x1000 — Volatile Memory controller
0xD0000000 TRACEDELAYREG_NS size 0x1000 — Trace delay register
0xE0080000 TRACEANDDEBUG_NS size 0x1000 — Trace And Debug

## Interrupts
1 MWU (MWU_NS)
16 MCPLL (MCPLL_NS)
18 RCOSC32K (RCOSC32K_NS)
21 CLOCK_POWER (CLOCK_NS, POWER_NS)
35 UARTE (UARTE_NS)
36 TIMER10 (TIMER1_NS)
37 TIMER11 (TIMER1_NS)
38 RTC (RTC_NS)
39 LWDT (LWDT_NS)
40 SWDT (SWDT_NS)
41 RNG (RNG_NS)
42 SIMIF (SIMIF_NS)
46 M2M0 (M2M0_NS)
47 M2M1 (M2M1_NS)
48 GPIOTE0 (GPIOTE0_NS)
49 GPIOTE1 (GPIOTE1_NS)
55 GPIOTE2 (GPIOTE2_NS)
57 TEMP (TEMP_NS)
59 LFCLKCALIBMEAS (LFCLKCALIBMEAS_NS)
60 TWIM (TWIM_NS)
66 AESL2 (AESL2_NS)
67 SNOW (SNOW_NS)
68 ZUC (ZUC_NS)
80 SHA (SHA_NS)
81 TLSAES (TLSAES_NS)
82 DESCIPHER (DESCIPHER_NS)
83 IPC0 (IPC_NS)
84 IPC1 (IPC_NS)
85 IPC2 (IPC_NS)
86 TIMER00 (TIMER0_NS)
87 TIMER01 (TIMER0_NS)
96 KMU (KMU_NS)

## Further device data
MaxInterrupts=240

## Licence text in the file
Copyright (c) 2010 - 2020, Nordic Semiconductor ASA . All rights reserved. . Redistribution and use in source and binary forms, with or without modification, are permitted provided that the following conditions are met: . 1. Redistributions of source code must retain the above copyright notice, this list of conditions and the following disclaimer. . 2. Redistributions in binary form, except as embedded into a Nordic. Semiconductor ASA integrated circuit in a product or a software update for such product, must reproduce the above copyright notice, this list of conditions and the following disclaimer in the documentation and/or other materials provided with the distribution. . 3. Neither the name of Nordic Semiconductor ASA nor the names of its contributors may be used to endorse or promote products derived from this software without specific prior written permission. . 4. This software, with or without modification, must only be used with a. Nordic Semiconductor ASA integrated circuit. . 5. Any software provided in binary form under this license must not be reverse engineered, decompiled, modified and/or disassembled. . THIS SOFTWARE IS PROVIDED BY NORDIC SEMICONDUCTOR ASA "AS IS" AND ANY EXPRESS. OR IMPLIED WARRANTIES, INCLUDING, BUT NOT LIMITED TO, THE IMPLIED WARRANTIES. OF MERCHANTABILITY, NONINFRINGEMENT, AND FITNESS FOR A PARTICULAR PURPOSE ARE. DISCLAIMED. IN NO EVENT SHALL NORDIC SEMICONDUCTOR ASA OR CONTRIBUTORS BE. LIABLE FOR ANY DIRECT, INDIRECT, INCIDENTAL, SPECIAL, EXEMPLARY, OR. CONSEQUENTIAL DAMAGES (INCLUDING, BUT NOT LIMITED TO, PROCUREMENT OF SUBSTITUTE. GOODS OR SERVICES; LOSS OF USE, DATA, OR PROFITS; OR BUSINESS INTERRUPTION). HOWEVER CAUSED AND ON ANY THEORY OF LIABILITY, WHETHER IN CONTRACT, STRICT. LIABILITY, OR TORT (INCLUDING NEGLIGENCE OR OTHERWISE) ARISING IN ANY WAY OUT. OF THE USE OF THIS SOFTWARE, EVEN IF ADVISED OF THE POSSIBILITY OF SUCH DAMAGE.
