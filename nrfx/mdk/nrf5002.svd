# nrf5002 register map
Vendor: Nordic Semiconductor; Series: nRF50; File version: 1
nRF5xx reference description for system-on-chip with ARM 32-bit Cortex-M microcontroller
CPU: CM0 r0p4, little endian, no MPU, no FPU, 2 interrupt priority bits, 32 interrupts
Registers are 32-bit, read-write, reset 0x0 unless marked. A register's access mark holds for its fields unless they carry their own. Offsets are from the block's base; lines under a group give offsets from that group; [hi:lo] are bit positions; {n}, {i} and the like mark numbered series; 'fields as' and 'values as' point back to an identical list; <NAME> marks a mode.

## Memory map
0x10000000 FICR size 0x1000 — Factory Information Configuration Registers
0x10001000 UICR size 0x1000 — User Information Configuration Registers
0x40000000 CLOCK size 0x1000 — Clock management
0x40000000 POWER size 0x1000 — Power control
0x40000000 RESET size 0x1000 — Reset control
0x40001000 OSCILLATORS size 0x1000 — Oscillator control
0x40001000 REGULATORS size 0x1000 — Regulator control
0x40002000 RADIO size 0x1000 — 2.4 GHz radio
0x40003000 RNG size 0x1000 — Random Number Generator
0x40004000 GPIOTE size 0x1000 — GPIO Tasks and Events
0x40005000 WDT size 0x1000 — Watchdog Timer
0x40006000 TIMER0 size 0x1000 — Timer/Counter 0
0x40007000 TIMER1 size 0x1000 — Timer/Counter 1
0x40008000 TIMER2 size 0x1000 — Timer/Counter 2
0x40009000 ECB size 0x1000 — AES ECB Mode Encryption
0x4000A000 CCM size 0x1000 — AES CCM mode encryption
0x4000A000 AAR size 0x1000 — Accelerated Address Resolver
0x4000B000 DPPIC size 0x1000 — Distributed programmable peripheral interconnect controller
0x4000C000 RTC0 size 0x1000 — Real-time counter 0
0x4000D000 RTC1 size 0x1000 — Real-time counter 1
0x4000E000 SPIM0 size 0x1000 — Serial Peripheral Interface Master with EasyDMA 0
0x4000E000 SPIS0 size 0x1000 — SPI Slave 0
0x4000E000 UARTE0 size 0x1000 — UART with EasyDMA
0x4000F000 TWIM1 size 0x1000 — I2C compatible Two-Wire Master Interface with EasyDMA
0x4000F000 TWIS1 size 0x1000 — I2C compatible Two-Wire Slave Interface with EasyDMA
0x40010000 SPIM2 size 0x1000 — Serial Peripheral Interface Master with EasyDMA 1
0x40010000 SPIS2 size 0x1000 — SPI Slave 1
0x40012000 QDEC0 size 0x1000 — Quadrature Decoder
0x40014000 SAADC size 0x1000 — Analog to Digital Converter
0x40017000 EGU0 size 0x1000 — Event generator unit
0x40019000 SWI0 size 0x1000 — Software interrupt 0
0x4001A000 SWI1 size 0x1000 — Software interrupt 1
0x4001B000 SWI2 size 0x1000 — Software interrupt 2
0x40020000 PAMLI size 0x1000 — Peripheral AHB Multi-Layer Interface
0x40022000 VMC size 0x1000 — Volatile Memory controller
0x40023000 BPROT size 0x1000 — Block Protect
0x40023000 NVMC size 0x1000 — Non Volatile Memory Controller
0x40025000 RAMBIST0 size 0x1000 — The RamBist perform hardware accelerated RAM tests
0x40027000 RCOSC32K size 0x1000 — 32.768 kHz RC oscillator
0x41000000 PCGCSLAVE_AMLI size 0x1000 — PCGCSlave
0x41000000 AMLI size 0x1000 — AHB Multi-Layer Interface
0x41001000 PCGCMASTER0 size 0x1000 — PCGC Master
0x50000000 P0 size 0x1000 — GPIO Port 0
0x50000300 P1 size 0x1000 — GPIO Port 1

## Interrupts
0 CLOCK_POWER (CLOCK, POWER)
2 RADIO
3 RNG
4 GPIOTE
5 WDT
6 TIMER0
7 TIMER1
8 TIMER2
9 ECB
10 CCM_AAR (CCM, AAR)
12 RTC0
13 RTC1
14 SPIM0_SPIS0_UARTE0 (SPIM0, SPIS0, UARTE0)
15 TWIM1_TWIS1 (TWIM1, TWIS1)
16 SPIM2_SPIS2 (SPIM2, SPIS2)
18 QDEC0
20 SAADC
23 EGU0
25 SWI0
26 SWI1
27 SWI2

## Further device data
MaxInterrupts=32

## Licence text in the file
Copyright (c) 2010 - 2020, Nordic Semiconductor ASA All rights reserved. Redistribution and use in source and binary forms, with or without modification, are permitted provided that the following conditions are met: 1. Redistributions of source code must retain the above copyright notice, this list of conditions and the following disclaimer. 2. Redistributions in binary form, except as embedded into a Nordic Semiconductor ASA integrated circuit in a product or a software update for such product, must reproduce the above copyright notice, this list of conditions and the following disclaimer in the documentation and/or other materials provided with the distribution. 3. Neither the name of Nordic Semiconductor ASA nor the names of its contributors may be used to endorse or promote products derived from this software without specific prior written permission. 4. This software, with or without modification, must only be used with a Nordic Semiconductor ASA integrated circuit. 5. Any software provided in binary form under this license must not be reverse engineered, decompiled, modified and/or disassembled. THIS SOFTWARE IS PROVIDED BY NORDIC SEMICONDUCTOR ASA "AS IS" AND ANY EXPRESS OR IMPLIED WARRANTIES, INCLUDING, BUT NOT LIMITED TO, THE IMPLIED WARRANTIES OF MERCHANTABILITY, NONINFRINGEMENT, AND FITNESS FOR A PARTICULAR PURPOSE ARE DISCLAIMED. IN NO EVENT SHALL NORDIC SEMICONDUCTOR ASA OR CONTRIBUTORS BE LIABLE FOR ANY DIRECT, INDIRECT, INCIDENTAL, SPECIAL, EXEMPLARY, OR CONSEQUENTIAL DAMAGES (INCLUDING, BUT NOT LIMITED TO, PROCUREMENT OF SUBSTITUTE GOODS OR SERVICES; LOSS OF USE, DATA, OR PROFITS; OR BUSINESS INTERRUPTION) HOWEVER CAUSED AND ON ANY THEORY OF LIABILITY, WHETHER IN CONTRACT, STRICT LIABILITY, OR TORT (INCLUDING NEGLIGENCE OR OTHERWISE) ARISING IN ANY WAY OUT OF THE USE OF THIS SOFTWARE, EVEN IF ADVISED OF THE POSSIBILITY OF SUCH DAMAGE.
