# haltium_secure register map
Vendor: Nordic Semiconductor; Series: nRFHaltium; File version: 1
nRFHaltium reference description for system-on-chip with many ARM 32-bit Cortex-M33 microcontrollers
CPU: CM33 r0p4, little endian, MPU, FPU, 3 interrupt priority bits, 480 interrupts
Registers are 32-bit, read-write, reset 0x0 unless marked. A register's access mark holds for its fields unless they carry their own. Offsets are from the block's base; lines under a group give offsets from that group; [hi:lo] are bit positions; {n}, {i} and the like mark numbered series; 'fields as' and 'values as' point back to an identical list; <NAME> marks a mode.

## Memory map
0x00410000 ETM_NS size 0x1000 — Embedded Trace Macrocell
0x00420000 CTI_NS size 0x1000 — Cross-Trigger Interface control. NOTE: this is not a separate peripheral, but describes CM33 functionality. 0
0x41003000 MVDMA_NS size 0x1000 — MVDMA performs direct-memory-accesses between memories. Data is transferred according to job descriptor lists. Each transfer has corresponding source and sink descriptor lists with matching data amounts. The lists are in memory and they contain data buffer information, address pointers, buffer sizes and data type attributes. MVDMA IP connects to an ARM standard AXI4 bus. 0
0x41004000 RAMC00_NS size 0x1000 — RAM Controller 0
0x41005000 ROMC00_NS size 0x1000 — RAM Controller 0
0x41006000 GENERIC1_NS size 0x1000 — GENERIC 11
0x41011000 CPUCONF_NS size 0x1000 — CPU Configuration 0
0x41012000 MEMCONF_NS size 0x1000 — Memory configuration 1
0x41013000 IPCT_NS size 0x1000 — IPCT APB registers 0
0x41014000 WDT0_NS size 0x1000 — Watchdog Timer 0
0x41015000 WDT1_NS size 0x1000 — Watchdog Timer 2
0x41017000 MUTEX_NS size 0x1000 — MUTEX 0
0x4F099000 BELLBOARD_NS size 0x1000 — BELLBOARD APB registers 0
0x4F8D1000 GLOBAL_GIPCT0_NS size 0x1000 — IPCT APB registers 0
0x4F8D2000 GLOBAL_GMUTEX0_NS size 0x1000 — MUTEX 2
0x4F8D3000 GLOBAL_GGENERIC55_NS size 0x1000 — GENERIC 19
0x4F8D4000 GLOBAL_GGENERIC56_NS size 0x1000 — GENERIC 21
0x4F8D5000 GLOBAL_GGENERIC57_NS size 0x1000 — GENERIC 23
0x4F8D6000 GLOBAL_GGENERIC58_NS size 0x1000 — GENERIC 25
0x4F8E1000 GLOBAL_GDPPIC0_NS size 0x1000 — Distributed programmable peripheral interconnect controller 0
0x4F8E2000 GLOBAL_GTIMER0_NS size 0x1000 — Timer/Counter 0
0x4F8E3000 GLOBAL_GTIMER1_NS size 0x1000 — Timer/Counter 2
0x4F8E4000 GLOBAL_PWM0_NS size 0x1000 — Pulse width modulation unit 0
0x4F8E5000 GLOBAL_SPIM0_NS size 0x1000 — Serial Peripheral Interface Master with EasyDMA 0
0x4F8E5000 GLOBAL_SPIS0_NS size 0x1000 — SPI Slave 0
0x4F8E5000 GLOBAL_TWIM0_NS size 0x1000 — I2C compatible Two-Wire Master Interface with EasyDMA 0
0x4F8E5000 GLOBAL_TWIS0_NS size 0x1000 — I2C compatible Two-Wire Slave Interface with EasyDMA 0
0x4F8E5000 GLOBAL_UARTE0_NS size 0x1000 — UART with EasyDMA 0
0x4F8E6000 GLOBAL_HSSPIM0_NS size 0x1000 — Serial Peripheral Interface Master with EasyDMA 0
0x4F8E7000 GLOBAL_HSSPIM1_NS size 0x1000 — Serial Peripheral Interface Master with EasyDMA 2
0x4F921000 GLOBAL_GIPCT1_NS size 0x1000 — IPCT APB registers 2
0x4F922000 GLOBAL_GDPPIC1_NS size 0x1000 — Distributed programmable peripheral interconnect controller 2
0x4F927000 GLOBAL_GMUTEX1_NS size 0x1000 — MUTEX 3
0x4F928000 GLOBAL_GRTC0_NS size 0x1000 — Real-time counter 0
0x4F929000 GLOBAL_GRTC1_NS size 0x1000 — Real-time counter 2
0x4F92B000 GLOBAL_GWDT1_NS size 0x1000 — Watchdog Timer 4
0x4F92C000 GLOBAL_GWDT2_NS size 0x1000 — Watchdog Timer 6
0x4F934000 GLOBAL_GPIOTE0_NS size 0x1000 — GPIO Tasks and Events 0
0x4F935000 GLOBAL_GPIOTE1_NS size 0x1000 — GPIO Tasks and Events 2
{0x4F938000+0x200*n} GLOBAL_P{n}_NS size 0x200 (n=0..7) — GPIO Port {n}
{0x4F938000+0x200*n} GLOBAL_P{n}_NS size 0x200 (n=8..15) — GPIO Port {n+8}
0x4F939E00 GLOBAL_GGPIOINTERNAL_NS size 0x2000 — GPIO Internal 0
0x4F981000 GLOBAL_GDPPIC2_NS size 0x1000 — Distributed programmable peripheral interconnect controller 4
0x4F982000 GLOBAL_SAADC_NS size 0x1000 — Analog to Digital Converter 0
0x4F983000 GLOBAL_COMP_NS size 0x1000 — Comparator 0
0x4F983000 GLOBAL_LPCOMP_NS size 0x1000 — Low-power comparator 0
0x4F984000 GLOBAL_TEMP_NS size 0x1000 — Temperature Sensor 0
0x4F985000 GLOBAL_NFCT_NS size 0x1000 — NFC-A compatible radio 0
0x4F991000 GLOBAL_GDPPIC3_NS size 0x1000 — Distributed programmable peripheral interconnect controller 6
0x4F992000 GLOBAL_I2S_NS size 0x1000 — Inter-IC Sound 0
0x4F993000 GLOBAL_PDM_NS size 0x1000 — Pulse Density Modulation (Digital Microphone) Interface 0
0x4F994000 GLOBAL_QDEC0_NS size 0x1000 — Quadrature Decoder 0
0x4F995000 GLOBAL_QDEC1_NS size 0x1000 — Quadrature Decoder 2
0x4F996000 GLOBAL_SIMIF_NS size 0x1000 — SIM card interface 0
0x4F997000 GLOBAL_GMIPIRFFE_NS size 0x1000 — MipiRffe Master 0
0x4F998000 GLOBAL_TWIM9_NS size 0x1000 — I2C compatible Two-Wire Master Interface with EasyDMA 2
0x4F9A1000 GLOBAL_GDPPIC4_NS size 0x1000 — Distributed programmable peripheral interconnect controller 8
0x4F9A2000 GLOBAL_GTIMER2_NS size 0x1000 — Timer/Counter 4
0x4F9A3000 GLOBAL_GTIMER3_NS size 0x1000 — Timer/Counter 6
0x4F9A4000 GLOBAL_PWM1_NS size 0x1000 — Pulse width modulation unit 2
0x4F9A5000 GLOBAL_SPIM1_NS size 0x1000 — Serial Peripheral Interface Master with EasyDMA 2
0x4F9A5000 GLOBAL_SPIS1_NS size 0x1000 — SPI Slave 2
0x4F9A5000 GLOBAL_TWIM1_NS size 0x1000 — I2C compatible Two-Wire Master Interface with EasyDMA 4
0x4F9A5000 GLOBAL_TWIS1_NS size 0x1000 — I2C compatible Two-Wire Slave Interface with EasyDMA 2
0x4F9A5000 GLOBAL_UARTE1_NS size 0x1000 — UART with EasyDMA 2
0x4F9A6000 GLOBAL_SPIM2_NS size 0x1000 — Serial Peripheral Interface Master with EasyDMA 4
0x4F9A6000 GLOBAL_SPIS2_NS size 0x1000 — SPI Slave 4
0x4F9A6000 GLOBAL_TWIM2_NS size 0x1000 — I2C compatible Two-Wire Master Interface with EasyDMA 6
0x4F9A6000 GLOBAL_TWIS2_NS size 0x1000 — I2C compatible Two-Wire Slave Interface with EasyDMA 4
0x4F9A6000 GLOBAL_UARTE2_NS size 0x1000 — UART with EasyDMA 4
0x4F9B1000 GLOBAL_GDPPIC5_NS size 0x1000 — Distributed programmable peripheral interconnect controller 10
0x4F9B2000 GLOBAL_GTIMER4_NS size 0x1000 — Timer/Counter 8
0x4F9B3000 GLOBAL_GTIMER5_NS size 0x1000 — Timer/Counter 10
0x4F9B4000 GLOBAL_PWM2_NS size 0x1000 — Pulse width modulation unit 4
0x4F9B5000 GLOBAL_SPIM3_NS size 0x1000 — Serial Peripheral Interface Master with EasyDMA 6
0x4F9B5000 GLOBAL_SPIS3_NS size 0x1000 — SPI Slave 6
0x4F9B5000 GLOBAL_TWIM3_NS size 0x1000 — I2C compatible Two-Wire Master Interface with EasyDMA 8
0x4F9B5000 GLOBAL_TWIS3_NS size 0x1000 — I2C compatible Two-Wire Slave Interface with EasyDMA 6
0x4F9B5000 GLOBAL_UARTE3_NS size 0x1000 — UART with EasyDMA 6
0x4F9B6000 GLOBAL_SPIM4_NS size 0x1000 — Serial Peripheral Interface Master with EasyDMA 8
0x4F9B6000 GLOBAL_SPIS4_NS size 0x1000 — SPI Slave 8
0x4F9B6000 GLOBAL_TWIM4_NS size 0x1000 — I2C compatible Two-Wire Master Interface with EasyDMA 10
0x4F9B6000 GLOBAL_TWIS4_NS size 0x1000 — I2C compatible Two-Wire Slave Interface with EasyDMA 8
0x4F9B6000 GLOBAL_UARTE4_NS size 0x1000 — UART with EasyDMA 8
0x4F9C1000 GLOBAL_GDPPIC6_NS size 0x1000 — Distributed programmable peripheral interconnect controller 12
0x4F9C2000 GLOBAL_GTIMER6_NS size 0x1000 — Timer/Counter 12
0x4F9C3000 GLOBAL_GTIMER7_NS size 0x1000 — Timer/Counter 14
0x4F9C4000 GLOBAL_PWM3_NS size 0x1000 — Pulse width modulation unit 6
0x4F9C5000 GLOBAL_SPIM5_NS size 0x1000 — Serial Peripheral Interface Master with EasyDMA 10
0x4F9C5000 GLOBAL_SPIS5_NS size 0x1000 — SPI Slave 10
0x4F9C5000 GLOBAL_TWIM5_NS size 0x1000 — I2C compatible Two-Wire Master Interface with EasyDMA 12
0x4F9C5000 GLOBAL_TWIS5_NS size 0x1000 — I2C compatible Two-Wire Slave Interface with EasyDMA 10
0x4F9C5000 GLOBAL_UARTE5_NS size 0x1000 — UART with EasyDMA 10
0x4F9C6000 GLOBAL_SPIM6_NS size 0x1000 — Serial Peripheral Interface Master with EasyDMA 12
0x4F9C6000 GLOBAL_SPIS6_NS size 0x1000 — SPI Slave 12
0x4F9C6000 GLOBAL_TWIM6_NS size 0x1000 — I2C compatible Two-Wire Master Interface with EasyDMA 14
0x4F9C6000 GLOBAL_TWIS6_NS size 0x1000 — I2C compatible Two-Wire Slave Interface with EasyDMA 12
0x4F9C6000 GLOBAL_UARTE6_NS size 0x1000 — UART with EasyDMA 12
0x4F9D1000 GLOBAL_GDPPIC7_NS size 0x1000 — Distributed programmable peripheral interconnect controller 14
0x4F9D2000 GLOBAL_GTIMER8_NS size 0x1000 — Timer/Counter 16
0x4F9D3000 GLOBAL_GTIMER9_NS size 0x1000 — Timer/Counter 18
0x4F9D4000 GLOBAL_PWM4_NS size 0x1000 — Pulse width modulation unit 8
0x4F9D5000 GLOBAL_SPIM7_NS size 0x1000 — Serial Peripheral Interface Master with EasyDMA 14
0x4F9D5000 GLOBAL_SPIS7_NS size 0x1000 — SPI Slave 14
0x4F9D5000 GLOBAL_TWIM7_NS size 0x1000 — I2C compatible Two-Wire Master Interface with EasyDMA 16
0x4F9D5000 GLOBAL_TWIS7_NS size 0x1000 — I2C compatible Two-Wire Slave Interface with EasyDMA 14
0x4F9D5000 GLOBAL_UARTE7_NS size 0x1000 — UART with EasyDMA 14
0x4F9D6000 GLOBAL_SPIM8_NS size 0x1000 — Serial Peripheral Interface Master with EasyDMA 16
0x4F9D6000 GLOBAL_SPIS8_NS size 0x1000 — SPI Slave 16
0x4F9D6000 GLOBAL_TWIM8_NS size 0x1000 — I2C compatible Two-Wire Master Interface with EasyDMA 18
0x4F9D6000 GLOBAL_TWIS8_NS size 0x1000 — I2C compatible Two-Wire Slave Interface with EasyDMA 16
0x4F9D6000 GLOBAL_UARTE8_NS size 0x1000 — UART with EasyDMA 16
0x51000000 SPU0_S size 0x1000 — System protection unit 1
0x51001000 MPC_S size 0x1000 — Memory Privilege Controller 1
0x51002000 GENERIC0_S size 0x1000 — GENERIC 10
0x51003000 MVDMA_S size 0x1000 — MVDMA performs direct-memory-accesses between memories. Data is transferred according to job descriptor lists. Each transfer has corresponding source and sink descriptor lists with matching data amounts. The lists are in memory and they contain data buffer information, address pointers, buffer sizes and data type attributes. MVDMA IP connects to an ARM standard AXI4 bus. 1
0x51004000 RAMC00_S size 0x1000 — RAM Controller 1
0x51005000 ROMC00_S size 0x1000 — RAM Controller 1
0x51006000 GENERIC1_S size 0x1000 — GENERIC 12
0x5100A000 GENERIC2_S size 0x1000 — GENERIC 13
0x5100B000 GENERIC3_S size 0x1000 — GENERIC 14
0x5100C000 ABB_S size 0x1000 — ABB
0x5100D000 HSFLL_S size 0x1000 — HSFLL 1
0x5100E000 LRC0_S size 0x1000 — LRC 1
0x5100F000 GENERIC6_S size 0x1000 — GENERIC 15
0x51010000 SPU1_S size 0x1000 — System protection unit 2
0x51011000 CPUCONF_S size 0x1000 — CPU Configuration 1
0x51012000 MEMCONF_S size 0x1000 — Memory configuration 2
0x51013000 IPCT_S size 0x1000 — IPCT APB registers 1
0x51014000 WDT0_S size 0x1000 — Watchdog Timer 1
0x51015000 WDT1_S size 0x1000 — Watchdog Timer 3
0x51016000 TAMPC_S size 0x1000 — Tamper controller
0x51017000 MUTEX_S size 0x1000 — MUTEX 1
0x5101C000 GENERIC7_S size 0x1000 — GENERIC 16
0x5101D000 GENERIC8_S size 0x1000 — GENERIC 17
0x5101E000 LRC1_S size 0x1000 — LRC 2
0x5101F000 GENERIC10_S size 0x1000 — GENERIC 18
0x5F080000 GSPU0_S size 0x1000 — System protection unit 3
0x5F081000 GMPC0_S size 0x1000 — Memory Privilege Controller 2
0x5F090000 GSPU1_S size 0x1000 — System protection unit 4
0x5F091000 GMPC1_S size 0x1000 — Memory Privilege Controller 3
0x5F099000 BELLBOARD_S size 0x1000 — BELLBOARD APB registers 1
0x5F8C0000 GSPU2_S size 0x1000 — System protection unit 5
0x5F8C1000 GMPC2_S size 0x1000 — Memory Privilege Controller 4
0x5F8D0000 GSPU3_S size 0x1000 — System protection unit 6
0x5F8D1000 GLOBAL_GIPCT0_S size 0x1000 — IPCT APB registers 1
0x5F8D3000 GLOBAL_GGENERIC55_S size 0x1000 — GENERIC 20
0x5F8D4000 GLOBAL_GGENERIC56_S size 0x1000 — GENERIC 22
0x5F8D5000 GLOBAL_GGENERIC57_S size 0x1000 — GENERIC 24
0x5F8D6000 GLOBAL_GGENERIC58_S size 0x1000 — GENERIC 26
0x5F8E0000 GSPU4_S size 0x1000 — System protection unit 7
0x5F8E1000 GLOBAL_GDPPIC0_S size 0x1000 — Distributed programmable peripheral interconnect controller 1
0x5F8E2000 GLOBAL_GTIMER0_S size 0x1000 — Timer/Counter 1
0x5F8E3000 GLOBAL_GTIMER1_S size 0x1000 — Timer/Counter 3
0x5F8E4000 GLOBAL_PWM0_S size 0x1000 — Pulse width modulation unit 1
0x5F8E5000 GLOBAL_SPIM0_S size 0x1000 — Serial Peripheral Interface Master with EasyDMA 1
0x5F8E5000 GLOBAL_SPIS0_S size 0x1000 — SPI Slave 1
0x5F8E5000 GLOBAL_TWIM0_S size 0x1000 — I2C compatible Two-Wire Master Interface with EasyDMA 1
0x5F8E5000 GLOBAL_TWIS0_S size 0x1000 — I2C compatible Two-Wire Slave Interface with EasyDMA 1
0x5F8E5000 GLOBAL_UARTE0_S size 0x1000 — UART with EasyDMA 1
0x5F8E6000 GLOBAL_HSSPIM0_S size 0x1000 — Serial Peripheral Interface Master with EasyDMA 1
0x5F8E7000 GLOBAL_HSSPIM1_S size 0x1000 — Serial Peripheral Interface Master with EasyDMA 3
0x5F900000 GSPU5_S size 0x1000 — System protection unit 8
0x5F901000 GMPC3_S size 0x1000 — Memory Privilege Controller 5
0x5F920000 GSPU6_S size 0x1000 — System protection unit 9
0x5F921000 GLOBAL_GIPCT1_S size 0x1000 — IPCT APB registers 3
0x5F922000 GLOBAL_GDPPIC1_S size 0x1000 — Distributed programmable peripheral interconnect controller 3
0x5F923000 IPCMAP_S size 0x1000 — IPCMAP APB registers
0x5F924000 IRQMAP_S size 0x1000 — IRQMAP APB registers
0x5F928000 GLOBAL_GRTC0_S size 0x1000 — Real-time counter 1
0x5F929000 GLOBAL_GRTC1_S size 0x1000 — Real-time counter 3
0x5F92B000 GLOBAL_GWDT1_S size 0x1000 — Watchdog Timer 5
0x5F92C000 GLOBAL_GWDT2_S size 0x1000 — Watchdog Timer 7
0x5F934000 GLOBAL_GPIOTE0_S size 0x1000 — GPIO Tasks and Events 1
0x5F935000 GLOBAL_GPIOTE1_S size 0x1000 — GPIO Tasks and Events 3
{0x5F938000+0x200*n} GLOBAL_P{n}_S size 0x200 (n=0..7) — GPIO Port {n+8}
{0x5F938000+0x200*n} GLOBAL_P{n}_S size 0x200 (n=8..15) — GPIO Port {n+16}
0x5F939E00 GLOBAL_GGPIOINTERNAL_S size 0x2000 — GPIO Internal 1
0x5F940000 GSPU7_S size 0x1000 — System protection unit 10
0x5F980000 GSPU8_S size 0x1000 — System protection unit 11
0x5F981000 GLOBAL_GDPPIC2_S size 0x1000 — Distributed programmable peripheral interconnect controller 5
0x5F982000 GLOBAL_SAADC_S size 0x1000 — Analog to Digital Converter 1
0x5F983000 GLOBAL_COMP_S size 0x1000 — Comparator 1
0x5F983000 GLOBAL_LPCOMP_S size 0x1000 — Low-power comparator 1
0x5F984000 GLOBAL_TEMP_S size 0x1000 — Temperature Sensor 1
0x5F985000 GLOBAL_NFCT_S size 0x1000 — NFC-A compatible radio 1
0x5F990000 GSPU9_S size 0x1000 — System protection unit 12
0x5F991000 GLOBAL_GDPPIC3_S size 0x1000 — Distributed programmable peripheral interconnect controller 7
0x5F992000 GLOBAL_I2S_S size 0x1000 — Inter-IC Sound 1
0x5F993000 GLOBAL_PDM_S size 0x1000 — Pulse Density Modulation (Digital Microphone) Interface 1
0x5F994000 GLOBAL_QDEC0_S size 0x1000 — Quadrature Decoder 1
0x5F995000 GLOBAL_QDEC1_S size 0x1000 — Quadrature Decoder 3
0x5F996000 GLOBAL_SIMIF_S size 0x1000 — SIM card interface 1
0x5F997000 GLOBAL_GMIPIRFFE_S size 0x1000 — MipiRffe Master 1
0x5F998000 GLOBAL_TWIM9_S size 0x1000 — I2C compatible Two-Wire Master Interface with EasyDMA 3
0x5F9A0000 GSPU10_S size 0x1000 — System protection unit 13
0x5F9A1000 GLOBAL_GDPPIC4_S size 0x1000 — Distributed programmable peripheral interconnect controller 9
0x5F9A2000 GLOBAL_GTIMER2_S size 0x1000 — Timer/Counter 5
0x5F9A3000 GLOBAL_GTIMER3_S size 0x1000 — Timer/Counter 7
0x5F9A4000 GLOBAL_PWM1_S size 0x1000 — Pulse width modulation unit 3
0x5F9A5000 GLOBAL_SPIM1_S size 0x1000 — Serial Peripheral Interface Master with EasyDMA 3
0x5F9A5000 GLOBAL_SPIS1_S size 0x1000 — SPI Slave 3
0x5F9A5000 GLOBAL_TWIM1_S size 0x1000 — I2C compatible Two-Wire Master Interface with EasyDMA 5
0x5F9A5000 GLOBAL_TWIS1_S size 0x1000 — I2C compatible Two-Wire Slave Interface with EasyDMA 3
0x5F9A5000 GLOBAL_UARTE1_S size 0x1000 — UART with EasyDMA 3
0x5F9A6000 GLOBAL_SPIM2_S size 0x1000 — Serial Peripheral Interface Master with EasyDMA 5
0x5F9A6000 GLOBAL_SPIS2_S size 0x1000 — SPI Slave 5
0x5F9A6000 GLOBAL_TWIM2_S size 0x1000 — I2C compatible Two-Wire Master Interface with EasyDMA 7
0x5F9A6000 GLOBAL_TWIS2_S size 0x1000 — I2C compatible Two-Wire Slave Interface with EasyDMA 5
0x5F9A6000 GLOBAL_UARTE2_S size 0x1000 — UART with EasyDMA 5
0x5F9B0000 GSPU11_S size 0x1000 — System protection unit 14
0x5F9B1000 GLOBAL_GDPPIC5_S size 0x1000 — Distributed programmable peripheral interconnect controller 11
0x5F9B2000 GLOBAL_GTIMER4_S size 0x1000 — Timer/Counter 9
0x5F9B3000 GLOBAL_GTIMER5_S size 0x1000 — Timer/Counter 11
0x5F9B4000 GLOBAL_PWM2_S size 0x1000 — Pulse width modulation unit 5
0x5F9B5000 GLOBAL_SPIM3_S size 0x1000 — Serial Peripheral Interface Master with EasyDMA 7
0x5F9B5000 GLOBAL_SPIS3_S size 0x1000 — SPI Slave 7
0x5F9B5000 GLOBAL_TWIM3_S size 0x1000 — I2C compatible Two-Wire Master Interface with EasyDMA 9
0x5F9B5000 GLOBAL_TWIS3_S size 0x1000 — I2C compatible Two-Wire Slave Interface with EasyDMA 7
0x5F9B5000 GLOBAL_UARTE3_S size 0x1000 — UART with EasyDMA 7
0x5F9B6000 GLOBAL_SPIM4_S size 0x1000 — Serial Peripheral Interface Master with EasyDMA 9
0x5F9B6000 GLOBAL_SPIS4_S size 0x1000 — SPI Slave 9
0x5F9B6000 GLOBAL_TWIM4_S size 0x1000 — I2C compatible Two-Wire Master Interface with EasyDMA 11
0x5F9B6000 GLOBAL_TWIS4_S size 0x1000 — I2C compatible Two-Wire Slave Interface with EasyDMA 9
0x5F9B6000 GLOBAL_UARTE4_S size 0x1000 — UART with EasyDMA 9
0x5F9C0000 GSPU12_S size 0x1000 — System protection unit 15
0x5F9C1000 GLOBAL_GDPPIC6_S size 0x1000 — Distributed programmable peripheral interconnect controller 13
0x5F9C2000 GLOBAL_GTIMER6_S size 0x1000 — Timer/Counter 13
0x5F9C3000 GLOBAL_GTIMER7_S size 0x1000 — Timer/Counter 15
0x5F9C4000 GLOBAL_PWM3_S size 0x1000 — Pulse width modulation unit 7
0x5F9C5000 GLOBAL_SPIM5_S size 0x1000 — Serial Peripheral Interface Master with EasyDMA 11
0x5F9C5000 GLOBAL_SPIS5_S size 0x1000 — SPI Slave 11
0x5F9C5000 GLOBAL_TWIM5_S size 0x1000 — I2C compatible Two-Wire Master Interface with EasyDMA 13
0x5F9C5000 GLOBAL_TWIS5_S size 0x1000 — I2C compatible Two-Wire Slave Interface with EasyDMA 11
0x5F9C5000 GLOBAL_UARTE5_S size 0x1000 — UART with EasyDMA 11
0x5F9C6000 GLOBAL_SPIM6_S size 0x1000 — Serial Peripheral Interface Master with EasyDMA 13
0x5F9C6000 GLOBAL_SPIS6_S size 0x1000 — SPI Slave 13
0x5F9C6000 GLOBAL_TWIM6_S size 0x1000 — I2C compatible Two-Wire Master Interface with EasyDMA 15
0x5F9C6000 GLOBAL_TWIS6_S size 0x1000 — I2C compatible Two-Wire Slave Interface with EasyDMA 13
0x5F9C6000 GLOBAL_UARTE6_S size 0x1000 — UART with EasyDMA 13
0x5F9D0000 GSPU13_S size 0x1000 — System protection unit 16
0x5F9D1000 GLOBAL_GDPPIC7_S size 0x1000 — Distributed programmable peripheral interconnect controller 15
0x5F9D2000 GLOBAL_GTIMER8_S size 0x1000 — Timer/Counter 17
0x5F9D3000 GLOBAL_GTIMER9_S size 0x1000 — Timer/Counter 19
0x5F9D4000 GLOBAL_PWM4_S size 0x1000 — Pulse width modulation unit 9
0x5F9D5000 GLOBAL_SPIM7_S size 0x1000 — Serial Peripheral Interface Master with EasyDMA 15
0x5F9D5000 GLOBAL_SPIS7_S size 0x1000 — SPI Slave 15
0x5F9D5000 GLOBAL_TWIM7_S size 0x1000 — I2C compatible Two-Wire Master Interface with EasyDMA 17
0x5F9D5000 GLOBAL_TWIS7_S size 0x1000 — I2C compatible Two-Wire Slave Interface with EasyDMA 15
0x5F9D5000 GLOBAL_UARTE7_S size 0x1000 — UART with EasyDMA 15
0x5F9D6000 GLOBAL_SPIM8_S size 0x1000 — Serial Peripheral Interface Master with EasyDMA 17
0x5F9D6000 GLOBAL_SPIS8_S size 0x1000 — SPI Slave 17
0x5F9D6000 GLOBAL_TWIM8_S size 0x1000 — I2C compatible Two-Wire Master Interface with EasyDMA 19
0x5F9D6000 GLOBAL_TWIS8_S size 0x1000 — I2C compatible Two-Wire Slave Interface with EasyDMA 17
0x5F9D6000 GLOBAL_UARTE8_S size 0x1000 — UART with EasyDMA 17
0x5F9E0000 GLOBAL_EASYVDMA_NS size 0x1000 — Vector-based DMA.
0xBF000000 GSPU14_S size 0x1000 — System protection unit 0
0xBF001000 GLOBAL_GGENERIC59_NS size 0x1000 — GENERIC 0
0xBF001000 GLOBAL_GGENERIC59_S size 0x1000 — GENERIC 1
0xBF002000 CTRLAP_S size 0x1000 — Control access port
0xBF003000 GLOBAL_GGENERIC60_NS size 0x1000 — GENERIC 2
0xBF003000 GLOBAL_GGENERIC60_S size 0x1000 — GENERIC 3
0xBF004000 GGENERIC0_S size 0x1000 — GENERIC 4
0xBF005000 GHSFLL2_S size 0x1000 — HSFLL 0
0xBF006000 GLRC2_S size 0x1000 — LRC 0
0xBF007000 GGENERIC61_S size 0x1000 — GENERIC 5
0xBF008000 GMPC4_S size 0x1000 — Memory Privilege Controller 0
0xBF009000 GMEMCONF2_S size 0x1000 — Memory configuration 0
0xBF041000 GLOBAL_TSGEN_NS size 0x1000 — GENERIC 6
0xBF042000 GLOBAL_STM_NS size 0x1000 — System Trace Macrocell
0xBF043000 GLOBAL_TPIU_NS size 0x1000 — Trace Port Interface Unit
0xBF044000 GLOBAL_ETB_NS size 0x1000 — GENERIC 7
0xBF045000 GLOBAL_ETR_NS size 0x1000 — GENERIC 8
0xBF046000 GLOBAL_CTI0_NS size 0x1000 — Cross-Trigger Interface control. NOTE: this is not a separate peripheral, but describes CM33 functionality. 1
0xBF047000 GLOBAL_CTI1_NS size 0x1000 — Cross-Trigger Interface control. NOTE: this is not a separate peripheral, but describes CM33 functionality. 2
0xBF048000 GLOBAL_ATBREPLICATOR0_NS size 0x1000 — ATB Replicator module 0
0xBF049000 GLOBAL_ATBREPLICATOR1_NS size 0x1000 — ATB Replicator module 1
0xBF04A000 GLOBAL_ATBREPLICATOR2_NS size 0x1000 — ATB Replicator module 2
0xBF04B000 GLOBAL_ATBREPLICATOR3_NS size 0x1000 — ATB Replicator module 3
0xBF04C000 GLOBAL_ATBFUNNEL0_NS size 0x1000 — ATB funnel module 0
0xBF04D000 GLOBAL_ATBFUNNEL1_NS size 0x1000 — ATB funnel module 1
0xBF04E000 GLOBAL_ATBFUNNEL2_NS size 0x1000 — ATB funnel module 2
0xBF04F000 GLOBAL_ATBFUNNEL3_NS size 0x1000 — ATB funnel module 3
0xE0042000 GENERIC11_S size 0x1000 — GENERIC 9
0xE0080000 CPUC_S size 0x1000 — CM33 SubSystem
0xE0082000 CACHE0_S size 0x1000 — Cache 0
0xE0083000 CACHE1_S size 0x1000 — Cache 1
0xE0F00000 CACHE0DATA_S size 0x1000 — CACHEDATA 0
0xE0F04000 CACHE1DATA_S size 0x1000 — CACHEDATA 1
0xE0F08000 CACHE0INFO_S size 0x1000 — CACHEINFO 0
0xE0F0C000 CACHE1INFO_S size 0x1000 — CACHEINFO 1

## Interrupts
0 SPU0 (SPU0_S)
1 MPC (MPC_S)
2 GENERIC0 (GENERIC0_S)
3 MVDMA (MVDMA_NS, MVDMA_S)
4 RAMC00 (RAMC00_NS, RAMC00_S)
5 ROMC00 (ROMC00_NS, ROMC00_S)
6 GENERIC1 (GENERIC1_NS, GENERIC1_S)
10 GENERIC2 (GENERIC2_S)
11 GENERIC3 (GENERIC3_S)
12 ABB (ABB_S)
13 HSFLL (HSFLL_S)
14 LRC0 (LRC0_S)
15 GENERIC6 (GENERIC6_S)
16 SPU1 (SPU1_S)
20 WDT0 (WDT0_NS, WDT0_S)
21 WDT1 (WDT1_NS, WDT1_S)
22 TAMPC (TAMPC_S)
28 GENERIC7 (GENERIC7_S)
29 GENERIC8 (GENERIC8_S)
30 LRC1 (LRC1_S)
31 GENERIC10 (GENERIC10_S)
64 IPCT0 (IPCT_NS, IPCT_S)
65 IPCT1 (IPCT_NS, IPCT_S)
96 BELLBOARD0 (BELLBOARD_NS, BELLBOARD_S)
97 BELLBOARD1 (BELLBOARD_NS, BELLBOARD_S)
98 BELLBOARD2 (BELLBOARD_NS, BELLBOARD_S)
99 BELLBOARD3 (BELLBOARD_NS, BELLBOARD_S)
104 GPIOTE00 (GLOBAL_GPIOTE0_NS, GLOBAL_GPIOTE0_S)
105 GPIOTE01 (GLOBAL_GPIOTE0_NS, GLOBAL_GPIOTE0_S)
106 GPIOTE10 (GLOBAL_GPIOTE1_NS, GLOBAL_GPIOTE1_S)
107 GPIOTE11 (GLOBAL_GPIOTE1_NS, GLOBAL_GPIOTE1_S)
128 GSPU0 (GSPU0_S)
129 GMPC0 (GMPC0_S)
144 GSPU1 (GSPU1_S)
145 GMPC1 (GMPC1_S)
192 GSPU2 (GSPU2_S)
193 GMPC2 (GMPC2_S)
208 GSPU3 (GSPU3_S)
209 GIPCT00 (GLOBAL_GIPCT0_NS, GLOBAL_GIPCT0_S)
211 GGENERIC55 (GLOBAL_GGENERIC55_NS, GLOBAL_GGENERIC55_S)
212 GGENERIC56 (GLOBAL_GGENERIC56_NS, GLOBAL_GGENERIC56_S)
213 GGENERIC57 (GLOBAL_GGENERIC57_NS, GLOBAL_GGENERIC57_S)
214 GGENERIC58 (GLOBAL_GGENERIC58_NS, GLOBAL_GGENERIC58_S)
224 GSPU4 (GSPU4_S)
226 GTIMER0 (GLOBAL_GTIMER0_NS, GLOBAL_GTIMER0_S)
227 GTIMER1 (GLOBAL_GTIMER1_NS, GLOBAL_GTIMER1_S)
228 PWM0 (GLOBAL_PWM0_NS, GLOBAL_PWM0_S)
229 SPIM0_SPIS0_TWIM0_TWIS0_UARTE0 (GLOBAL_SPIM0_NS, GLOBAL_SPIS0_NS, GLOBAL_TWIM0_NS, GLOBAL_TWIS0_NS, GLOBAL_UARTE0_NS, GLOBAL_SPIM0_S, GLOBAL_SPIS0_S, GLOBAL_TWIM0_S, GLOBAL_TWIS0_S, GLOBAL_UARTE0_S)
230 HSSPIM0 (GLOBAL_HSSPIM0_NS, GLOBAL_HSSPIM0_S)
231 HSSPIM1 (GLOBAL_HSSPIM1_NS, GLOBAL_HSSPIM1_S)
256 GSPU5 (GSPU5_S)
257 GMPC3 (GMPC3_S)
288 GSPU6 (GSPU6_S)
289 GIPCT10 (GLOBAL_GIPCT1_NS, GLOBAL_GIPCT1_S)
296 GRTC0 (GLOBAL_GRTC0_NS, GLOBAL_GRTC0_S)
297 GRTC1 (GLOBAL_GRTC1_NS, GLOBAL_GRTC1_S)
299 GWDT1 (GLOBAL_GWDT1_NS, GLOBAL_GWDT1_S)
300 GWDT2 (GLOBAL_GWDT2_NS, GLOBAL_GWDT2_S)
320 GSPU7 (GSPU7_S)
384 GSPU8 (GSPU8_S)
386 SAADC (GLOBAL_SAADC_NS, GLOBAL_SAADC_S)
387 COMP_LPCOMP (GLOBAL_COMP_NS, GLOBAL_LPCOMP_NS, GLOBAL_COMP_S, GLOBAL_LPCOMP_S)
388 TEMP (GLOBAL_TEMP_NS, GLOBAL_TEMP_S)
389 NFCT (GLOBAL_NFCT_NS, GLOBAL_NFCT_S)
400 GSPU9 (GSPU9_S)
402 I2S (GLOBAL_I2S_NS, GLOBAL_I2S_S)
403 PDM (GLOBAL_PDM_NS, GLOBAL_PDM_S)
404 QDEC0 (GLOBAL_QDEC0_NS, GLOBAL_QDEC0_S)
405 QDEC1 (GLOBAL_QDEC1_NS, GLOBAL_QDEC1_S)
406 SIMIF (GLOBAL_SIMIF_NS, GLOBAL_SIMIF_S)
407 GMIPIRFFE (GLOBAL_GMIPIRFFE_NS, GLOBAL_GMIPIRFFE_S)
408 TWIM9 (GLOBAL_TWIM9_NS, GLOBAL_TWIM9_S)
416 GSPU10 (GSPU10_S)
418 GTIMER2 (GLOBAL_GTIMER2_NS, GLOBAL_GTIMER2_S)
419 GTIMER3 (GLOBAL_GTIMER3_NS, GLOBAL_GTIMER3_S)
420 PWM1 (GLOBAL_PWM1_NS, GLOBAL_PWM1_S)
421 SPIM1_SPIS1_TWIM1_TWIS1_UARTE1 (GLOBAL_SPIM1_NS, GLOBAL_SPIS1_NS, GLOBAL_TWIM1_NS, GLOBAL_TWIS1_NS, GLOBAL_UARTE1_NS, GLOBAL_SPIM1_S, GLOBAL_SPIS1_S, GLOBAL_TWIM1_S, GLOBAL_TWIS1_S, GLOBAL_UARTE1_S)
422 SPIM2_SPIS2_TWIM2_TWIS2_UARTE2 (GLOBAL_SPIM2_NS, GLOBAL_SPIS2_NS, GLOBAL_TWIM2_NS, GLOBAL_TWIS2_NS, GLOBAL_UARTE2_NS, GLOBAL_SPIM2_S, GLOBAL_SPIS2_S, GLOBAL_TWIM2_S, GLOBAL_TWIS2_S, GLOBAL_UARTE2_S)
432 GSPU11 (GSPU11_S)
434 GTIMER4 (GLOBAL_GTIMER4_NS, GLOBAL_GTIMER4_S)
435 GTIMER5 (GLOBAL_GTIMER5_NS, GLOBAL_GTIMER5_S)
436 PWM2 (GLOBAL_PWM2_NS, GLOBAL_PWM2_S)
437 SPIM3_SPIS3_TWIM3_TWIS3_UARTE3 (GLOBAL_SPIM3_NS, GLOBAL_SPIS3_NS, GLOBAL_TWIM3_NS, GLOBAL_TWIS3_NS, GLOBAL_UARTE3_NS, GLOBAL_SPIM3_S, GLOBAL_SPIS3_S, GLOBAL_TWIM3_S, GLOBAL_TWIS3_S, GLOBAL_UARTE3_S)
438 SPIM4_SPIS4_TWIM4_TWIS4_UARTE4 (GLOBAL_SPIM4_NS, GLOBAL_SPIS4_NS, GLOBAL_TWIM4_NS, GLOBAL_TWIS4_NS, GLOBAL_UARTE4_NS, GLOBAL_SPIM4_S, GLOBAL_SPIS4_S, GLOBAL_TWIM4_S, GLOBAL_TWIS4_S, GLOBAL_UARTE4_S)
448 GSPU12 (GSPU12_S)
450 GTIMER6 (GLOBAL_GTIMER6_NS, GLOBAL_GTIMER6_S)
451 GTIMER7 (GLOBAL_GTIMER7_NS, GLOBAL_GTIMER7_S)
452 PWM3 (GLOBAL_PWM3_NS, GLOBAL_PWM3_S)
453 SPIM5_SPIS5_TWIM5_TWIS5_UARTE5 (GLOBAL_SPIM5_NS, GLOBAL_SPIS5_NS, GLOBAL_TWIM5_NS, GLOBAL_TWIS5_NS, GLOBAL_UARTE5_NS, GLOBAL_SPIM5_S, GLOBAL_SPIS5_S, GLOBAL_TWIM5_S, GLOBAL_TWIS5_S, GLOBAL_UARTE5_S)
454 SPIM6_SPIS6_TWIM6_TWIS6_UARTE6 (GLOBAL_SPIM6_NS, GLOBAL_SPIS6_NS, GLOBAL_TWIM6_NS, GLOBAL_TWIS6_NS, GLOBAL_UARTE6_NS, GLOBAL_SPIM6_S, GLOBAL_SPIS6_S, GLOBAL_TWIM6_S, GLOBAL_TWIS6_S, GLOBAL_UARTE6_S)
464 GSPU13 (GSPU13_S)
466 GTIMER8 (GLOBAL_GTIMER8_NS, GLOBAL_GTIMER8_S)
467 GTIMER9 (GLOBAL_GTIMER9_NS, GLOBAL_GTIMER9_S)
468 PWM4 (GLOBAL_PWM4_NS, GLOBAL_PWM4_S)
469 SPIM7_SPIS7_TWIM7_TWIS7_UARTE7 (GLOBAL_SPIM7_NS, GLOBAL_SPIS7_NS, GLOBAL_TWIM7_NS, GLOBAL_TWIS7_NS, GLOBAL_UARTE7_NS, GLOBAL_SPIM7_S, GLOBAL_SPIS7_S, GLOBAL_TWIM7_S, GLOBAL_TWIS7_S, GLOBAL_UARTE7_S)
470 SPIM8_SPIS8_TWIM8_TWIS8_UARTE8 (GLOBAL_SPIM8_NS, GLOBAL_SPIS8_NS, GLOBAL_TWIM8_NS, GLOBAL_TWIS8_NS, GLOBAL_UARTE8_NS, GLOBAL_SPIM8_S, GLOBAL_SPIS8_S, GLOBAL_TWIM8_S, GLOBAL_TWIS8_S, GLOBAL_UARTE8_S)

## Further device data
MaxInterrupts=480

## Licence text in the file
Copyright (c) 2010 - 2020, Nordic Semiconductor ASA All rights reserved. Redistribution and use in source and binary forms, with or without modification, are permitted provided that the following conditions are met: 1. Redistributions of source code must retain the above copyright notice, this list of conditions and the following disclaimer. 2. Redistributions in binary form, except as embedded into a Nordic Semiconductor ASA integrated circuit in a product or a software update for such product, must reproduce the above copyright notice, this list of conditions and the following disclaimer in the documentation and/or other materials provided with the distribution. 3. Neither the name of Nordic Semiconductor ASA nor the names of its contributors may be used to endorse or promote products derived from this software without specific prior written permission. 4. This software, with or without modification, must only be used with a Nordic Semiconductor ASA integrated circuit. 5. Any software provided in binary form under this license must not be reverse engineered, decompiled, modified and/or disassembled. THIS SOFTWARE IS PROVIDED BY NORDIC SEMICONDUCTOR ASA "AS IS" AND ANY EXPRESS OR IMPLIED WARRANTIES, INCLUDING, BUT NOT LIMITED TO, THE IMPLIED WARRANTIES OF MERCHANTABILITY, NONINFRINGEMENT, AND FITNESS FOR A PARTICULAR PURPOSE ARE DISCLAIMED. IN NO EVENT SHALL NORDIC SEMICONDUCTOR ASA OR CONTRIBUTORS BE LIABLE FOR ANY DIRECT, INDIRECT, INCIDENTAL, SPECIAL, EXEMPLARY, OR CONSEQUENTIAL DAMAGES (INCLUDING, BUT NOT LIMITED TO, PROCUREMENT OF SUBSTITUTE GOODS OR SERVICES; LOSS OF USE, DATA, OR PROFITS; OR BUSINESS INTERRUPTION) HOWEVER CAUSED AND ON ANY THEORY OF LIABILITY, WHETHER IN CONTRACT, STRICT LIABILITY, OR TORT (INCLUDING NEGLIGENCE OR OTHERWISE) ARISING IN ANY WAY OUT OF THE USE OF THIS SOFTWARE, EVEN IF ADVISED OF THE POSSIBILITY OF SUCH DAMAGE.
